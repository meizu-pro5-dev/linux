## Documentation/devicetree/bindings/sound/ess,ess9018k2m.yaml
```yaml
# SPDX-License-Identifier: GPL-2.0-only OR BSD-2-Clause
%YAML 1.2
---
$id: http://devicetree.org/schemas/sound/ess,ess9018k2m.yaml#
$schema: http://devicetree.org/meta-schemas/core.yaml#

title: ESS Technology ES9018K2M Hi-Fi DAC

maintainers:
  - 404698-FDU <pro5-mainline@local>

properties:
  compatible:
    const: ess,ess9018k2m

  reg:
    maxItems: 1

  osc48k-gpios:
    maxItems: 1

  osc44k-gpios:
    maxItems: 1

  reset-gpios:
    maxItems: 1

  mute-gpios:
    maxItems: 1

  open-gpios:
    maxItems: 1

  low-gain-gpios:
    maxItems: 1

  out-select-gpios:
    maxItems: 1

  dvdd18-gpios:
    maxItems: 1

  "#sound-dai-cells":
    const: 0

required:
  - compatible
  - reg

additionalProperties: false
```

## Documentation/devicetree/bindings/sound/samsung,meizu-m86-audio.yaml
```yaml
# SPDX-License-Identifier: GPL-2.0-only OR BSD-2-Clause
%YAML 1.2
---
$id: http://devicetree.org/schemas/sound/samsung,meizu-m86-audio.yaml#
$schema: http://devicetree.org/meta-schemas/core.yaml#

title: Meizu PRO 5 (m86) Audio Machine

maintainers:
  - 404698-FDU <pro5-mainline@local>

properties:
  compatible:
    const: samsung,meizu-m86-audio

  model:
    $ref: /schemas/types.yaml#/definitions/string

  samsung,pmu:
    $ref: /schemas/types.yaml#/definitions/phandle
    description: Phandle to the PMU system controller.

  samsung,rtc:
    $ref: /schemas/types.yaml#/definitions/phandle
    description: Phandle to the SoC RTC controller for audio clock control.

  samsung,dsp:
    $ref: /schemas/types.yaml#/definitions/phandle
    description: Phandle to the eS705 SPI DSP device node.

  dsp-reset-gpios:
    maxItems: 1

  dsp-wakeup-gpios:
    maxItems: 1

  dsp-core-supply: true

  audio-amplifier:
    $ref: /schemas/types.yaml#/definitions/phandle

  hifi-cpu:
    $ref: /schemas/types.yaml#/definitions/phandle-array

  hifi-dac:
    $ref: /schemas/types.yaml#/definitions/phandle

  samsung,audio-routing:
    $ref: /schemas/types.yaml#/definitions/non-unique-string-array
    description: Audio routing pairs mapping board jacks and widgets.

  samsung,i2s-controller:
    $ref: /schemas/types.yaml#/definitions/phandle
    description: Phandle to the SoC I2S DAI controller.

  samsung,audio-codec:
    $ref: /schemas/types.yaml#/definitions/phandle
    description: Phandle to the WM8998 audio codec node.

  amic-bias-gpios:
    maxItems: 1

required:
  - compatible

additionalProperties: true
```

## drivers/media/platform/samsung/exynos7420-fimc-bns/Kconfig
```kconfig
# SPDX-License-Identifier: GPL-2.0-only
config VIDEO_EXYNOS7420_FIMC_BNS
	tristate "Samsung Exynos7420 FIMC-BNS raw capture"
	depends on ARCH_EXYNOS || COMPILE_TEST
	depends on HAS_DMA && OF
	depends on VIDEO_DEV
	select MEDIA_CONTROLLER
	select V4L2_FWNODE
	select VIDEO_V4L2_SUBDEV_API
	select VIDEOBUF2_DMA_CONTIG
	help
	  Raw Bayer DMA capture through the FIMC-BNS (FIMC-LITE) blocks that
	  follow the MIPI CSIS receivers on Exynos7420.
```

## drivers/misc/mipi-lli/Kconfig
```kconfig
# SPDX-License-Identifier: GPL-2.0-only
config MIPI_LLI
	tristate "Exynos MIPI LLI host controller"
	depends on ARCH_EXYNOS || COMPILE_TEST
	select EXYNOS_MIPI_LLI_MPHY
	help
	  MIPI Low Latency Interface controller of Exynos 7420, used as the
	  shared-memory link to the Shannon 333 modem.

config EXYNOS_MIPI_LLI_MPHY
	tristate
```

## drivers/misc/modem_v1/Kconfig
```kconfig
# SPDX-License-Identifier: GPL-2.0-only
config SEC_MODEM_IF_V1
	tristate "Samsung Shannon 333 modem interface (LLI)"
	depends on MIPI_LLI && SPI && NET
	help
	  Samsung modem interface driver for the Shannon 333 CP on Exynos 7420:
	  SPI bootloader download, MIPI-LLI shared memory IPC, character
	  io devices (umts_*) and rmnet network interfaces.
```
