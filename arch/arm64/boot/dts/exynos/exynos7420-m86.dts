// SPDX-License-Identifier: GPL-2.0-only
/*
 * Meizu PRO 5 (m86) board description.
 * Board wiring: meizuosc/m576 ubuntu 5a0c442 and archived m86 raw DTB.
 * Requires the project's pinned Exynos7420 SoC patch (A53 + MCT nodes).
 */
/dts-v1/;

#include "exynos7.dtsi"
#include <dt-bindings/clock/exynos7-clk.h>
#include <dt-bindings/gpio/gpio.h>
#include <dt-bindings/input/input.h>
#include <dt-bindings/input/ti-drv260x.h>
#include <dt-bindings/interrupt-controller/arm-gic.h>
#include <dt-bindings/interrupt-controller/irq.h>
#include <dt-bindings/leds/common.h>
#include <dt-bindings/thermal/thermal.h>
#include <dt-bindings/usb/pd.h>

/ {
	model = "Meizu PRO 5 (m86) Linux first boot";
	compatible = "meizu,m86", "samsung,exynos7420", "samsung,exynos7";

	aliases {
		/* PMIC RTC keeps rtc0 for hctosys; the SoC RTC only provides alarms. */
		rtc0 = &m86_pmic;
		rtc1 = &rtc;
		serial0 = &serial_2;
		serial4 = &serial_4;
		i2c2 = &hsi2c_2;
		i2c6 = &hsi2c_6;
		i2c8 = &hsi2c_8;
		i2c10 = &hsi2c_10;
		i2c11 = &hsi2c_11;
		i2c5 = &hsi2c_5;
	};

	m86_rtc_32k: clock-rtc-32k {
		compatible = "fixed-clock";
		#clock-cells = <0>;
		clock-frequency = <32768>;
		clock-output-names = "m86_rtc_32k";
	};

	chosen {
		stdout-path = "serial0:115200n8";
		bootargs = "earlycon=exynos4210,0x14c30000 console=ttySAC0,115200n8 console=tty0 rdinit=/init maxcpus=8 loglevel=4 nokaslr panic=5 oops=panic drm.vblankoffdelay=100 drm.dumb_render_allow=1";
	};

	/*
	 * Built-in FDT: 3 GiB base map + placeholder for 4 GiB high bank
	 * [0x1_0000_0000, 0x1_4000_0000), populated at boot from firmware FDT.
	 */
	memory@40000000 {
		device_type = "memory";
		reg = <0x0 0x40000000 0x0 0xc0000000>,
		      <0x1 0x00000000 0x0 0x00000000>;
	};

	reserved-memory {
		#address-cells = <2>;
		#size-cells = <2>;
		ranges;

		/* MIPI-LLI AP<->CP shared IPC memory (stock 3.10 mipi_lli_reserved) */
		modem_shmem: mipi-lli@e1000000 {
			reg = <0x0 0xe1000000 0x0 0x00800000>;
			no-map;
		};

		/*
		 * Preserves only the bootloader display handoff buffer (through 0xe4800000).
		 * Reclaimed: vendor-log (32 MiB) and legacy media/video (335.5 MiB).
		 */
		vendor-reserved@e1800000 {
			reg = <0x0 0xe1800000 0x0 0x03000000>;
			no-map;
		};

		/*
		 * Stock 3.10 allocates seclog (512 KiB), reset_reason (1 MiB) and
		 * ramoops (2 MiB) top-down below 0xf9800000; seclog was observed
		 * at 0xf9780000, which places the stock ramoops at 0xf9480000.
		 */
		ramoops@f9480000 {
			compatible = "ramoops";
			reg = <0x0 0xf9480000 0x0 0x00200000>;
			record-size = <0x40000>;
			console-size = <0x80000>;
			pmsg-size = <0x40000>;
			no-map;
		};

		/* Observed on 860BCMT226FG; matches the original Recovery SECLOG. */
		seclog@f9780000 {
			reg = <0x0 0xf9780000 0x0 0x00080000>;
			no-map;
		};

		vendor-reserved@f9800000 {
			reg = <0x0 0xf9800000 0x0 0x06800000>;
			no-map;
		};

		/*
		 * MFC buffers must sit above the firmware block (RISC base,
		 * 0x20000000); keep the IOVA allocator out of the range below.
		 */
		mfc_iova_resv: mfc-iova-reserved {
			iommu-addresses = <&mfc 0x0 0x20000000>;
		};
	};

	reg_vsys: regulator-vsys {
		compatible = "regulator-fixed";
		regulator-name = "vsys";
		regulator-min-microvolt = <3800000>;
		regulator-max-microvolt = <3800000>;
		regulator-always-on;
	};

	m86_gpio_keys: gpio-keys {
		compatible = "gpio-keys";
		pinctrl-names = "default";
		pinctrl-0 = <&m86_keys_pins>;

		key-power {
			label = "Power";
			linux,code = <KEY_POWER>;
			gpios = <&gpa2 4 GPIO_ACTIVE_LOW>;
			debounce-interval = <25>;
			wakeup-source;
		};
		key-volume-down {
			label = "Volume down";
			linux,code = <KEY_VOLUMEDOWN>;
			gpios = <&gpa1 2 GPIO_ACTIVE_LOW>;
			debounce-interval = <10>;
		};
		key-volume-up {
			label = "Volume up";
			linux,code = <KEY_VOLUMEUP>;
			gpios = <&gpa0 7 GPIO_ACTIVE_LOW>;
			debounce-interval = <10>;
		};
		key-home {
			label = "Home";
			linux,code = <KEY_LEFTMETA>;
			gpios = <&gpa3 2 GPIO_ACTIVE_LOW>;
			debounce-interval = <10>;
			wakeup-source;
		};
	};

	fpc_irq: fpc1155-mback {
		compatible = "meizu,m86-fpc1155", "fpc,fpc_irq";
		irq-gpios = <&gpa2 2 GPIO_ACTIVE_HIGH>;
		reset-gpios = <&gpv7 4 GPIO_ACTIVE_HIGH>;
		vdd-supply = <&ldo14_reg>;
		clocks = <&clock_peric1 PCLK_SPI4>, <&clock_peric1 SCLK_SPI4>;
		clock-names = "pclk", "sclk";
		pinctrl-names = "default";
		pinctrl-0 = <&fpc_irq_pin &fpc_rst_pin>;
		wakeup-source;
	};

	dvdd29_tf: regulator-tf-2v9 {
		compatible = "regulator-fixed";
		regulator-name = "vmmc_sdcard";
		regulator-min-microvolt = <2900000>;
		regulator-max-microvolt = <2900000>;
		gpio = <&gpf2 2 GPIO_ACTIVE_HIGH>;
		enable-active-high;
	};

	trng {
		compatible = "samsung,exynos7420-trng", "samsung,exynos850-trng";
	};

	m86_dsim_phy: dsim-phy {
		compatible = "samsung,exynos7420-mipi-video-phy";
		samsung,pmu-syscon = <&pmu_system_controller>;
		samsung,disp-sysreg = <&sysreg>;
		#phy-cells = <1>;
	};

	/*
	 * Native DSIM host (samsung-dsim) with the S6E3FA3 panel driver. DECON
	 * keeps the bootloader command-mode setup; without display-timings it
	 * creates no DPI encoder, so the DSI encoder drives the CRTC.
	 */
	m86_dsim: dsi@13900000 {
		compatible = "samsung,exynos7420-mipi-dsi";
		power-domains = <&pd_disp>;
		reg = <0x0 0x13900000 0x0 0x1000>;
		interrupt-parent = <&gic>;
		interrupts = <GIC_SPI 196 IRQ_TYPE_LEVEL_HIGH>;
		clocks = <&cmu_disp CLK_PCLK_DSIM0>, <&fin_pll>,
			 <&cmu_disp CLK_PHYCLK_MIPIDPHY0_BITCLKDIV8>,
			 <&cmu_disp CLK_PHYCLK_MIPIDPHY0_RXCLKESC0>,
			 <&cmu_disp CLK_SCLK_RGB_VCLK_TO_DSIM0>;
		clock-names = "bus_clk", "sclk_mipi",
			      "phyclk_mipidphy0_bitclkdiv8",
			      "phyclk_mipidphy0_rxclkesc0", "sclk_rgb_vclk_to_dsim0";
		assigned-clocks = <&cmu_disp CLK_MOUT_MIPIDPHY0_BIT>,
				  <&cmu_disp CLK_MOUT_MIPIDPHY0_RX>;
		assigned-clock-parents = <&cmu_disp CLK_FOUT_MIPIDPHY0_BIT>,
					 <&cmu_disp CLK_FOUT_MIPIDPHY0_RX>;
		phys = <&m86_dsim_phy 0>;
		phy-names = "dsim";
		samsung,pll-clock-frequency = <24000000>;
		samsung,burst-clock-frequency = <650000000>;
		samsung,esc-clock-frequency = <20000000>;
		samsung,mic-enabled;
		status = "okay";
		#address-cells = <1>;
		#size-cells = <0>;

		ports {
			#address-cells = <1>;
			#size-cells = <0>;

			port@0 {
				reg = <0>;
				m86_dsim_in: endpoint {
					remote-endpoint = <&m86_decon_out>;
				};
			};

			port@1 {
				reg = <1>;
				m86_dsim_out: endpoint {
					remote-endpoint = <&m86_panel_in>;
					data-lanes = <0 1>;
				};
			};
		};

		m86_panel: panel@0 {
			compatible = "meizu,m86-s6e3fa3";
			/* No te-gpios: DECON owns the gpc0-1 TE EINT and triggers frames. */
			reg = <0>;
			vci-supply = <&m86_lcd_3v3>;
			vdd3-supply = <&m86_lcd_1v8>;
			reset-gpios = <&gpc3 3 GPIO_ACTIVE_LOW>;

			port {
				m86_panel_in: endpoint {
					remote-endpoint = <&m86_dsim_out>;
				};
			};
		};
	};

	cmu_bus0: clock-controller@13400000 {
		compatible = "samsung,exynos7-clock-bus0";
		reg = <0x0 0x13400000 0x0 0x1000>;
		#clock-cells = <1>;
		clocks = <&fin_pll>, <&clock_topc CLK_ACLK_BUS0_532>;
		clock-names = "fin_pll", "top_aclk_bus0_532";
	};

	/* CPU cluster clocks (m86-cpu-clocks), switched via the TOPC safe mux. */
	m86_atlas_clk: m86-atlas-clock@11800000 {
		compatible = "meizu,m86-atlas-clock";
		reg = <0 0x11800000 0 0x1000>;
		#clock-cells = <0>;
		clocks = <&clock_topc CLK_MOUT_BUS0_ATLAS>, <&fin_pll>;
		clock-names = "safe", "fin";
		meizu,max-validated-frequency = <2100000000>;
	};

	m86_apollo_clk: m86-apollo-clock@11900000 {
		compatible = "meizu,m86-apollo-clock";
		reg = <0 0x11900000 0 0x1000>;
		#clock-cells = <0>;
		clocks = <&clock_topc CLK_MOUT_BUS0_APOLLO>, <&fin_pll>;
		clock-names = "safe", "fin";
		meizu,max-validated-frequency = <1500000000>;
	};

	bus_mif_opp_table: opp-table-mif {
		compatible = "operating-points-v2";

		opp-100000000 {
			opp-hz = /bits/ 64 <100000000>;
			opp-microvolt = <600000>;
			required-opps = <&int_opp_100>;
		};
		opp-133000000 {
			opp-hz = /bits/ 64 <133000000>;
			opp-microvolt = <600000>;
			required-opps = <&int_opp_200>;
		};
		opp-167000000 {
			opp-hz = /bits/ 64 <167000000>;
			opp-microvolt = <600000>;
			required-opps = <&int_opp_200>;
		};
		opp-276000000 {
			opp-hz = /bits/ 64 <276000000>;
			opp-microvolt = <600000>;
			required-opps = <&int_opp_200>;
		};
		opp-348000000 {
			opp-hz = /bits/ 64 <348000000>;
			opp-microvolt = <600000>;
			required-opps = <&int_opp_200>;
		};
		opp-416000000 {
			opp-hz = /bits/ 64 <416000000>;
			opp-microvolt = <600000>;
			required-opps = <&int_opp_200>;
		};
		opp-543000000 {
			opp-hz = /bits/ 64 <543000000>;
			opp-microvolt = <668750>;
			required-opps = <&int_opp_200>;
		};
		opp-632000000 {
			opp-hz = /bits/ 64 <632000000>;
			opp-microvolt = <681250>;
			required-opps = <&int_opp_266>;
		};
		opp-828000000 {
			opp-hz = /bits/ 64 <828000000>;
			opp-microvolt = <725000>;
			required-opps = <&int_opp_334>;
		};
		opp-1026000000 {
			opp-hz = /bits/ 64 <1026000000>;
			opp-microvolt = <743750>;
			required-opps = <&int_opp_500>;
		};
		opp-1264000000 {
			opp-hz = /bits/ 64 <1264000000>;
			opp-microvolt = <768750>;
			required-opps = <&int_opp_520>;
		};
		opp-1456000000 {
			opp-hz = /bits/ 64 <1456000000>;
			opp-microvolt = <800000>;
			required-opps = <&int_opp_540>;
		};
		opp-1552000000 {
			opp-hz = /bits/ 64 <1552000000>;
			opp-microvolt = <837500>;
			required-opps = <&int_opp_560>;
		};
	};

	bus_int_opp_table: opp-table-int {
		compatible = "operating-points-v2";

		int_opp_100: opp-100000000 {
			opp-hz = /bits/ 64 <100000000>;
			opp-microvolt = <700000>;
		};
		int_opp_200: opp-200000000 {
			opp-hz = /bits/ 64 <200000000>;
			opp-microvolt = <700000>;
		};
		int_opp_266: opp-266000000 {
			opp-hz = /bits/ 64 <266000000>;
			opp-microvolt = <700000>;
		};
		int_opp_334: opp-334000000 {
			opp-hz = /bits/ 64 <334000000>;
			opp-microvolt = <700000>;
		};
		int_opp_400: opp-400000000 {
			opp-hz = /bits/ 64 <400000000>;
			opp-microvolt = <725000>;
		};
		int_opp_500: opp-500000000 {
			opp-hz = /bits/ 64 <500000000>;
			opp-microvolt = <750000>;
		};
		int_opp_510: opp-510000000 {
			opp-hz = /bits/ 64 <510000000>;
			opp-microvolt = <750000>;
		};
		int_opp_520: opp-520000000 {
			opp-hz = /bits/ 64 <520000000>;
			opp-microvolt = <750000>;
		};
		int_opp_530: opp-530000000 {
			opp-hz = /bits/ 64 <530000000>;
			opp-microvolt = <750000>;
		};
		int_opp_540: opp-540000000 {
			opp-hz = /bits/ 64 <540000000>;
			opp-microvolt = <750000>;
		};
		int_opp_550: opp-550000000 {
			opp-hz = /bits/ 64 <550000000>;
			opp-microvolt = <806250>;
		};
		int_opp_560: opp-560000000 {
			opp-hz = /bits/ 64 <560000000>;
			opp-microvolt = <806250>;
		};
	};

	bus_mif: bus-mif {
		compatible = "samsung,exynos-bus";
		operating-points-v2 = <&bus_mif_opp_table>;
		#interconnect-cells = <0>;
		clocks = <&clock_topc CLK_FOUT_MIF_PLL>,
			 <&clock_topc CLK_MOUT_TOPC_MIF_PLL>,
			 <&clock_topc CLK_MOUT_SCLK_BUS0_PLL_MIF>,
			 <&clock_topc CLK_DOUT_SCLK_BUS0_PLL_MIF>,
			 <&clock_topc CLK_SCLK_BUS0_PLL_MIF>,
			 <&clock_topc CLK_MOUT_ACLK_MIF_PLL>,
			 <&clock_topc CLK_ACLK_MIF_LOGICAL>,
			 <&clock_topc CLK_MOUT_ACLK_CCORE_532>,
			 <&clock_topc CLK_DOUT_ACLK_CCORE_532>,
			 <&clock_topc DOUT_ACLK_CCORE_133>,
			 <&clock_topc ACLK_CCORE_133>;
		clock-names = "mif_pll", "mout_topc_mif_pll",
			      "mout_sclk_bus0_pll_mif", "dout_sclk_bus0_pll_mif",
			      "sclk_bus0_pll_mif", "mout_aclk_mif_pll",
			      "aclk_mif_logical", "mout_ccore_532",
			      "dout_ccore_532", "dout_ccore_133",
			      "aclk_ccore_133";
		samsung,sysreg = <&sysreg>;
		vdd-supply = <&m86_buck1_mif>;
		status = "okay";
	};

	bus_int: bus-int {
		compatible = "samsung,exynos-bus";
		operating-points-v2 = <&bus_int_opp_table>;
		#interconnect-cells = <0>;
		interconnects = <&bus_mif>;
		clocks = <&clock_topc CLK_MOUT_ACLK_BUS0_532>,
			 <&clock_topc CLK_DOUT_ACLK_BUS0_532>,
			 <&clock_topc CLK_ACLK_BUS0_532>,
			 <&clock_topc CLK_MOUT_ACLK_BUS1_532>,
			 <&clock_topc CLK_DOUT_ACLK_BUS1_532>,
			 <&clock_topc CLK_ACLK_BUS1_532>,
			 <&clock_topc CLK_MOUT_ACLK_BUS1_200>,
			 <&clock_topc CLK_DOUT_ACLK_BUS1_200>,
			 <&clock_topc CLK_ACLK_BUS1_200>,
			 <&clock_topc CLK_MOUT_PCLK_BUS01_133>,
			 <&clock_topc CLK_DOUT_PCLK_BUS01_133>,
			 <&clock_topc CLK_PCLK_BUS0_133>,
			 <&clock_topc CLK_MOUT_ACLK_IMEM_266>,
			 <&clock_topc CLK_DOUT_ACLK_IMEM_266>,
			 <&clock_topc CLK_ACLK_IMEM_266>,
			 <&clock_topc CLK_MOUT_ACLK_IMEM_200>,
			 <&clock_topc CLK_DOUT_ACLK_IMEM_200>,
			 <&clock_topc CLK_ACLK_IMEM_200>;
		clock-names = "mout_bus0_532", "dout_bus0_532", "aclk_bus0_532",
			      "mout_bus1_532", "dout_bus1_532", "aclk_bus1_532",
			      "mout_bus1_200", "dout_bus1_200", "aclk_bus1_200",
			      "mout_pclk_133", "dout_pclk_133", "pclk_bus0_133",
			      "mout_imem_266", "dout_imem_266", "aclk_imem_266",
			      "mout_imem_200", "dout_imem_200", "aclk_imem_200";
		samsung,sysreg = <&sysreg>;
		vdd-supply = <&m86_buck4_int>;
		devfreq = <&bus_mif>;
		status = "okay";
	};

	/*
	 * Uses the unit-specific ASV/EMA fuse and MIF evidence; the driver
	 * refuses to run unless the boot EMA register readbacks match.
	 */
	m86_cpu_dvfs: m86-cpu-coordinator {
		compatible = "meizu,m86-cpu-coordinator";
		meizu,ema-syscon = <&sysreg>;
		clocks = <&m86_atlas_clk>, <&m86_apollo_clk>, <&fin_pll>,
			 <&clock_topc CLK_ACLK_MIF_LOGICAL>;
		clock-names = "atlas", "apollo", "fin", "mif";
		atlas-supply = <&m86_buck2_cpu>;
		apollo-supply = <&m86_buck3_cpu>;
		samsung,tmu = <&tmuctrl_0 &tmuctrl_1 &tmuctrl_2 &tmuctrl_3>;
		meizu,max-validated-khz = <2100000 1500000>;
		status = "okay";
		meizu,cpu-dvfs-active;
		samsung,bus = <&bus_mif>;
	};

	m86_gpu_opps: opp-table-gpu {
		compatible = "operating-points-v2";
		/*
		 * Group 0 nominal voltages; exynos7420-asv adjusts per-chip ASV
		 * voltages at devfreq init. Pairwise opp-peak-kBps scales
		 * <&bus_int &bus_mif> (INT) and <&bus_mif &bus_mif> (MIF).
		 */
		opp-266000000 {
			opp-hz = /bits/ 64 <266000000>;
			opp-microvolt = <762500>;
			opp-peak-kBps = <1280000 3328000>;
		};
		opp-350000000 {
			opp-hz = /bits/ 64 <350000000>;
			opp-microvolt = <768750>;
			opp-peak-kBps = <1600000 4344000>;
		};
		opp-420000000 {
			opp-hz = /bits/ 64 <420000000>;
			opp-microvolt = <775000>;
			opp-peak-kBps = <2136000 8208000>;
		};
		opp-544000000 {
			opp-hz = /bits/ 64 <544000000>;
			opp-microvolt = <812500>;
			opp-peak-kBps = <3304000 8208000>;
		};
		opp-600000000 {
			opp-hz = /bits/ 64 <600000000>;
			opp-microvolt = <850000>;
			opp-peak-kBps = <3304000 12416000>;
		};
		opp-700000000 {
			opp-hz = /bits/ 64 <700000000>;
			opp-microvolt = <893750>;
			opp-peak-kBps = <3200000 12416000>;
		};
		/* Retained for a separately validated 772 MHz experiment. */
		opp-772000000 {
			opp-hz = /bits/ 64 <772000000>;
			opp-microvolt = <931250>;
			opp-peak-kBps = <3200000 12416000>;
			status = "disabled";
		};
	};

	sound {
		compatible = "samsung,meizu-m86-audio";
		model = "Meizu-PRO5";
		samsung,dsp = <&es705>;
		audio-amplifier = <&audio_pa_tfa9890>;
		hifi-cpu = <&i2s0 0>;
		hifi-dac = <&ess9018k2m>;
		samsung,audio-routing =
			"Headphone", "HPOUTL",
			"Headphone", "HPOUTR",
			"Earpiece", "EPOUT",
			"Speaker", "OUT",
			"Headset Mic", "MICBIAS1",
			"IN2B", "Headset Mic",
			"Main Mic", "MICBIAS2",
			"IN1AL", "Main Mic";
		audio-codec = <&audio_codec_wm8998 1>;
		i2s-controller = <&i2s1 0>;
		status = "okay";
	};

	i2c_fcam: i2c-vl6180 {
		compatible = "i2c-gpio";
		sda-gpios = <&gpc2 2 (GPIO_ACTIVE_HIGH | GPIO_OPEN_DRAIN)>;
		scl-gpios = <&gpc2 3 (GPIO_ACTIVE_HIGH | GPIO_OPEN_DRAIN)>;
		i2c-gpio,delay-us = <2>;
		pinctrl-names = "default";
		pinctrl-0 = <&vl6180_i2c_pins>;
		#address-cells = <1>;
		#size-cells = <0>;

		tof@29 {
			compatible = "st,vl6180";
			reg = <0x29>;
			vdd-supply = <&ldo25_reg>;
			enable-gpios = <&gpd7 2 GPIO_ACTIVE_HIGH>;
			interrupt-parent = <&gpc3>;
			interrupts = <6 IRQ_TYPE_EDGE_FALLING>;
			pinctrl-names = "default";
			pinctrl-0 = <&vl6180_en_pin &vl6180_irq_pin>;
			st,disable-als;
		};
	};

	i2c-lp5562 {
		compatible = "i2c-gpio";
		sda-gpios = <&gpf1 6 (GPIO_ACTIVE_HIGH | GPIO_OPEN_DRAIN)>;
		scl-gpios = <&gpf1 7 (GPIO_ACTIVE_HIGH | GPIO_OPEN_DRAIN)>;
		i2c-gpio,delay-us = <2>;
		pinctrl-names = "default";
		pinctrl-0 = <&lp5562_i2c_pins>;
		#address-cells = <1>;
		#size-cells = <0>;

		led-controller@30 {
			compatible = "ti,lp5562";
			reg = <0x30>;
			clock-mode = /bits/ 8 <1>;
			enable-gpios = <&gpf5 4 GPIO_ACTIVE_HIGH>;
			pinctrl-names = "default";
			pinctrl-0 = <&lp5562_en_pin>;
			#address-cells = <1>;
			#size-cells = <0>;

			led@0 {
				reg = <0>;
				chan-name = "m86:white:breath";
				color = <LED_COLOR_ID_WHITE>;
				led-cur = /bits/ 8 <80>;
				max-cur = /bits/ 8 <80>;
				linux,default-trigger = "heartbeat";
			};
		};
	};

	i2c-lm3644 {
		compatible = "i2c-gpio";
		sda-gpios = <&gpc2 4 (GPIO_ACTIVE_HIGH | GPIO_OPEN_DRAIN)>;
		scl-gpios = <&gpc2 5 (GPIO_ACTIVE_HIGH | GPIO_OPEN_DRAIN)>;
		i2c-gpio,delay-us = <2>;
		pinctrl-names = "default";
		pinctrl-0 = <&lm3644_i2c_pins>;
		#address-cells = <1>;
		#size-cells = <0>;

		flash-led-controller@63 {
			compatible = "ti,leds-lm3644", "ti,lm3644";
			reg = <0x63>;
			hwen-gpios = <&gpc0 4 GPIO_ACTIVE_HIGH>;
			strobe-gpios = <&gpc0 0 GPIO_ACTIVE_HIGH>;
			pinctrl-names = "default";
			pinctrl-0 = <&lm3644_ctrl_pins>;
		};
	};
};

&{/cpus} {
	/* Native capacity parsing requires a complete cpu-map. */
	cpu-map {
		cluster0 {
			core0 {
				cpu = <&cpu_apollo0>;
			};
			core1 {
				cpu = <&cpu_apollo1>;
			};
			core2 {
				cpu = <&cpu_apollo2>;
			};
			core3 {
				cpu = <&cpu_apollo3>;
			};
		};
		cluster1 {
			core0 {
				cpu = <&cpu_atlas0>;
			};
			core1 {
				cpu = <&cpu_atlas1>;
			};
			core2 {
				cpu = <&cpu_atlas2>;
			};
			core3 {
				cpu = <&cpu_atlas3>;
			};
		};
	};

	apollo_l2: l2-cache1 {
		compatible = "cache";
		cache-level = <2>;
		cache-unified;
	};
};

&{/thermal-zones} {
	apollo_thermal: cluster1-thermal {
		polling-delay-passive = <1000>;
		polling-delay = <0>;
		thermal-sensors = <&tmuctrl_1>;

		trips {
			apollo_alert_0: alert-0 {
				temperature = <65000>;
				hysteresis = <5000>;
				type = "passive";
			};
			apollo_alert_1: alert-1 {
				temperature = <75000>;
				hysteresis = <5000>;
				type = "passive";
			};
			apollo_hot_0: hot-0 {
				temperature = <85000>;
				hysteresis = <5000>;
				type = "hot";
			};
			apollo_crit_0: crit-0 {
				temperature = <95000>;
				hysteresis = <5000>;
				type = "critical";
			};
		};

		cooling-maps {
			map0 {
				trip = <&apollo_alert_1>;
				cooling-device = <&gpu THERMAL_NO_LIMIT THERMAL_NO_LIMIT>;
			};
		};
	};

	gpu_thermal: gpu-thermal {
		polling-delay-passive = <1000>;
		polling-delay = <0>;
		thermal-sensors = <&tmuctrl_2>;

		trips {
			gpu_alert_0: alert-0 {
				temperature = <65000>;
				hysteresis = <5000>;
				type = "passive";
			};
			gpu_alert_1: alert-1 {
				temperature = <75000>;
				hysteresis = <5000>;
				type = "passive";
			};
			gpu_hot_0: hot-0 {
				temperature = <85000>;
				hysteresis = <5000>;
				type = "hot";
			};
			gpu_crit_0: crit-0 {
				temperature = <95000>;
				hysteresis = <5000>;
				type = "critical";
			};
		};

		cooling-maps {
			map0 {
				trip = <&gpu_alert_1>;
				cooling-device = <&gpu THERMAL_NO_LIMIT THERMAL_NO_LIMIT>;
			};
		};
	};

	isp_thermal: isp-thermal {
		polling-delay-passive = <1000>;
		polling-delay = <0>;
		thermal-sensors = <&tmuctrl_3>;

		trips {
			isp_alert_0: alert-0 {
				temperature = <65000>;
				hysteresis = <5000>;
				type = "passive";
			};
			isp_alert_1: alert-1 {
				temperature = <75000>;
				hysteresis = <5000>;
				type = "passive";
			};
			isp_hot_0: hot-0 {
				temperature = <85000>;
				hysteresis = <5000>;
				type = "hot";
			};
			isp_crit_0: crit-0 {
				temperature = <95000>;
				hysteresis = <5000>;
				type = "critical";
			};
		};

		cooling-maps {
			map0 {
				trip = <&isp_alert_1>;
				cooling-device = <&gpu THERMAL_NO_LIMIT THERMAL_NO_LIMIT>;
			};
		};
	};
};

/* 24 MHz arch timer; the virtual timer PPI is not listed. */
&{/timer} {
	clock-frequency = <24000000>;
	interrupt-names = "sec-phys", "phys", "hyp-phys";
	interrupts = <GIC_PPI 13 (GIC_CPU_MASK_SIMPLE(8) | IRQ_TYPE_LEVEL_LOW)>,
		     <GIC_PPI 14 (GIC_CPU_MASK_SIMPLE(8) | IRQ_TYPE_LEVEL_LOW)>,
		     <GIC_PPI 10 (GIC_CPU_MASK_SIMPLE(8) | IRQ_TYPE_LEVEL_LOW)>;
};

&adma {
	status = "okay";
};

&atlas_thermal {
	polling-delay-passive = <1000>;
	polling-delay = <0>;
	/delete-node/ trips;

	trips {
		atlas_alert_0: alert-0 {
			temperature = <65000>;
			hysteresis = <5000>;
			type = "passive";
		};
		atlas_alert_1: alert-1 {
			temperature = <75000>;
			hysteresis = <5000>;
			type = "passive";
		};
		atlas_hot_0: hot-0 {
			temperature = <85000>;
			hysteresis = <5000>;
			type = "hot";
		};
		atlas_crit_0: crit-0 {
			temperature = <95000>;
			hysteresis = <5000>;
			type = "critical";
		};
	};

	cooling-maps {
		map0 {
			trip = <&atlas_alert_1>;
			cooling-device = <&gpu THERMAL_NO_LIMIT THERMAL_NO_LIMIT>;
		};
	};
};

&cmu_aud {
	status = "okay";
};

&cmu_disp {
	status = "okay";
};

&cmu_g3d {
	status = "okay";
};

/*
 * Relative per-MHz capacities derived from the Android nominal max-capacity
 * ratio 419/1024 at 1.5/2.1 GHz. arch_topology multiplies by each policy max
 * frequency: 2933*1500*1024/(5120*2100)=419, not 419*1500/(1024*2100).
 * Nominal compatibility values, not new DMIPS benchmark measurements.
 */
&cpu_apollo0 {
	cpu-supply = <&m86_buck3_cpu>;
	clocks = <&m86_apollo_clk>;
	capacity-dmips-mhz = <2933>;
	next-level-cache = <&apollo_l2>;
};

&cpu_apollo1 {
	cpu-supply = <&m86_buck3_cpu>;
	clocks = <&m86_apollo_clk>;
	capacity-dmips-mhz = <2933>;
	next-level-cache = <&apollo_l2>;
};

&cpu_apollo2 {
	cpu-supply = <&m86_buck3_cpu>;
	clocks = <&m86_apollo_clk>;
	capacity-dmips-mhz = <2933>;
	next-level-cache = <&apollo_l2>;
};

&cpu_apollo3 {
	cpu-supply = <&m86_buck3_cpu>;
	clocks = <&m86_apollo_clk>;
	capacity-dmips-mhz = <2933>;
	next-level-cache = <&apollo_l2>;
};

&cpu_atlas0 {
	cpu-supply = <&m86_buck2_cpu>;
	clocks = <&m86_atlas_clk>;
	capacity-dmips-mhz = <5120>;
};

&cpu_atlas1 {
	cpu-supply = <&m86_buck2_cpu>;
	clocks = <&m86_atlas_clk>;
	capacity-dmips-mhz = <5120>;
};

&cpu_atlas2 {
	cpu-supply = <&m86_buck2_cpu>;
	clocks = <&m86_atlas_clk>;
	capacity-dmips-mhz = <5120>;
};

&cpu_atlas3 {
	cpu-supply = <&m86_buck2_cpu>;
	clocks = <&m86_atlas_clk>;
	capacity-dmips-mhz = <5120>;
};

&decon {
	/*
	 * The bootloader leaves the DISP PLL at 134 MHz and VCLK at 33.5 MHz,
	 * which needs ~21 ms per command-mode frame, so every other 60 Hz
	 * frame is dropped. Set the vendor rates for this 1080p MIC panel in
	 * the vendor order (decon_int_set_clocks(): DISP PLL 267 MHz, the
	 * closest table rate being 266 MHz, then VCLK 60 MHz): VCLK becomes
	 * 266 / 5 = 53.2 MHz.
	 */
	assigned-clocks = <&cmu_disp CLK_FOUT_DISP_PLL>,
			  <&cmu_disp CLK_DOUT_SUB_SCLK_DECON_INT_VCLK>;
	assigned-clock-rates = <266000000>, <60000000>;
	te-gpios = <&gpc0 1 GPIO_ACTIVE_HIGH>;
	samsung,bus = <&bus_mif>;
	interconnects = <&bus_int &bus_mif>;
	interconnect-names = "dma-mem";
	status = "okay";

	i80-if-timings {
	};

	ports {
		#address-cells = <1>;
		#size-cells = <0>;

		port@0 {
			reg = <0>;
			m86_decon_out: endpoint {
				remote-endpoint = <&m86_dsim_in>;
			};
		};
	};
};

&fin_pll {
	clock-frequency = <24000000>;
};

/* G3D power (pd_g3d) and clocks (cmu_g3d) via standard genpd + CCF. */
&gpu {
	status = "okay";
	mali-supply = <&m86_buck6_g3d>;
	clocks = <&cmu_g3d CLK_ACLK_G3D>, <&cmu_g3d CLK_PCLK_SYSREG_G3D>;
	clock-names = "core", "bus";
	power-domains = <&pd_g3d>;
	interconnects = <&bus_int &bus_mif>, <&bus_mif &bus_mif>;
	operating-points-v2 = <&m86_gpu_opps>;
	#cooling-cells = <2>;
};

&hsi2c_0 {
	status = "okay";
	clock-frequency = <400000>;

	sensor-hub@3a {
		compatible = "meizu,m86-cwmcu", "st,sensor_hub";
		reg = <0x3a>;
		vdd-supply = <&ldo17_reg>;
		interrupt-parent = <&gpa1>;
		interrupts = <7 IRQ_TYPE_EDGE_FALLING>;
		wakeup-gpios = <&gpf3 3 GPIO_ACTIVE_HIGH>;
		sleep-gpios = <&gpf0 2 GPIO_ACTIVE_HIGH>;
		busy-gpios = <&gpf4 5 GPIO_ACTIVE_HIGH>;
		reset-gpios = <&gpr0 0 GPIO_ACTIVE_HIGH>;
		boot0-gpios = <&gpr0 2 GPIO_ACTIVE_HIGH>;
		mount-matrix = "-1", "0", "0",
			       "0", "-1", "0",
			       "0", "0", "1";
		pinctrl-names = "default";
		pinctrl-0 = <&cwmcu_irq_pin &cwmcu_wkup_pin &cwmcu_in_pins &cwmcu_ctrl_pins>;
		wakeup-source;
	};
};

&hsi2c_1 {
	status = "okay";
	clock-frequency = <400000>;

	audio_codec_wm8998: audio-codec-wm8998@1a {
		compatible = "wlf,wm8998";
		reg = <0x1a>;
		interrupt-parent = <&gpa3>;
		interrupts = <6 IRQ_TYPE_LEVEL_HIGH>;

		wlf,reset = <&gpd0 1 GPIO_ACTIVE_HIGH>;
		reset-gpios = <&gpd0 1 GPIO_ACTIVE_HIGH>;
		wlf,ldoena = <&gpj0 2 GPIO_ACTIVE_HIGH>;

		wlf,micd-ranges = <
			105 226 /* KEY_MEDIA */
			270 115 /* KEY_VOLUMEUP */
			752 114 /* KEY_VOLUMEDOWN */ >;
		wlf,micd-configs = <0 1 0>;
		wlf,micbias1 = <2600 0 1 0 0>;
		wlf,micbias2 = <1800 0 1 0 0>;
		wlf,micbias3 = <1800 0 1 0 0>;
		wlf,clk32k-src = <2>; /* MCLK2 */
		wlf,micd-detect-debounce = <500>;
		wlf,micd-bias-start-time = <9>;
		wlf,micd-rate = <5>;
		wlf,micd-dbtime = <1>;
		wlf,micd-force-micbias = <1>;
		wlf,micd-open-circuit-declare = <1>;

		#sound-dai-cells = <1>;
		clocks = <&pmu_system_controller 0>, <&rtc>;
		clock-names = "mclk1", "mclk2";

		AVDD-supply = <&m86_wm8998_1v8>;
		LDOVDD-supply = <&m86_wm8998_1v8>;
		DBVDD-supply = <&m86_wm8998_1v8>;
		DBVDD1-supply = <&m86_wm8998_1v8>;
		DBVDD2-supply = <&m86_wm8998_1v8>;
		DBVDD3-supply = <&m86_wm8998_1v8>;
		CPVDD-supply = <&m86_wm8998_1v8>;
		SPKVDD-supply = <&m86_wm8998_1v8>;
		SPKVDDL-supply = <&m86_wm8998_1v8>;
		SPKVDDR-supply = <&m86_wm8998_1v8>;
	};
};

&hsi2c_2 {
	status = "okay";
	clock-frequency = <400000>;

	haptics@5a {
		compatible = "ti,drv2605";
		reg = <0x5a>;
		vbat-supply = <&reg_vsys>;
		enable-gpios = <&gpf1 1 GPIO_ACTIVE_HIGH>;
		mode = <DRV260X_LRA_NO_CAL_MODE>;
		library-sel = <DRV260X_LIB_LRA>;
		vib-rated-mv = <1757>;
		vib-overdrive-mv = <2900>;
		pinctrl-names = "default";
		pinctrl-0 = <&motor_en_pin>;
	};
};

&hsi2c_4 {
	status = "okay";
	clock-frequency = <400000>;

	touchscreen@49 {
		compatible = "meizu,m86-fts";
		reg = <0x49>;
		pinctrl-names = "default";
		pinctrl-0 = <&m86_touch_irq_pin>;
		interrupt-parent = <&gpa1>;
		interrupts = <1 IRQ_TYPE_LEVEL_LOW>;
		touchscreen-size-x = <1080>;
		touchscreen-size-y = <1920>;
		/* Sleep while the panel is unprepared (DPMS off, suspend). */
		panel = <&m86_panel>;
	};
};

/*
 * PMIC hardware HSI2C_5 (0x13670000). exynos5_i2c_m86_apm_guard() verifies
 * and holds non-running Cortex-M3 APM in reset before selecting apm_safe_bus
 * (gpg3-2/gpg3-3 FUNC_2), preventing any default pinctrl bind before the guard.
 */
&hsi2c_5 {
	status = "okay";
	clock-frequency = <400000>;
	meizu,pmu = <&pmu_system_controller>;
	pinctrl-names = "apm_safe_bus";
	pinctrl-0 = <&hs_i2c5_bus>;

	m86_pmic: pmic@66 {
		compatible = "samsung,s2mps15-pmic";
		reg = <0x66>;
		meizu,skip-undescribed-rails;
		meizu,int-ldo8-coupler;
		/* No PMIC IRQ: no RTC alarm or wakeup from the PMIC. */
		regulators {
			/* Dynamic MIF, CPU, and INT rails: BUCK1, BUCK2, BUCK3, BUCK4 */
			m86_buck1_mif: BUCK1 {
				regulator-name = "vdd_mif";
				regulator-min-microvolt = <500000>;
				regulator-max-microvolt = <1100000>;
				regulator-always-on;
				meizu,cached-voltage-rail;
			};
			m86_buck2_cpu: BUCK2 {
				regulator-name = "vdd_atlas";
				regulator-min-microvolt = <500000>;
				regulator-max-microvolt = <1300000>;
				regulator-always-on;
				meizu,cpu-dvfs-active;
			};
			m86_buck3_cpu: BUCK3 {
				regulator-name = "vdd_apollo";
				regulator-min-microvolt = <500000>;
				regulator-max-microvolt = <1200000>;
				regulator-always-on;
				meizu,cpu-dvfs-active;
			};
			m86_buck4_int: BUCK4 {
				regulator-name = "vdd_int";
				regulator-min-microvolt = <500000>;
				regulator-max-microvolt = <1000000>;
				regulator-always-on;
				meizu,cached-voltage-rail;
				regulator-coupled-with = <&m86_ldo8_int_m &m86_buck5_disp>;
				regulator-coupled-max-spread = <400000 500000>;
			};
			m86_buck5_disp: BUCK5 {
				regulator-name = "vdd_disp";
				regulator-min-microvolt = <500000>;
				regulator-max-microvolt = <1100000>;
				regulator-boot-on;
				regulator-always-on;
				regulator-coupled-with = <&m86_buck4_int &m86_ldo8_int_m>;
				regulator-coupled-max-spread = <500000 400000>;
			};
			m86_ldo8_int_m: LDO8 {
				regulator-name = "vdd_int_m";
				regulator-min-microvolt = <700000>;
				regulator-max-microvolt = <1100000>;
				regulator-boot-on;
				regulator-always-on;
				meizu,cached-voltage-rail;
				regulator-coupled-with = <&m86_buck4_int &m86_buck5_disp>;
				regulator-coupled-max-spread = <400000 400000>;
			};
			m86_buck6_g3d: BUCK6 {
				regulator-name = "vdd_g3d";
				regulator-min-microvolt = <500000>;
				regulator-max-microvolt = <1100000>;
				regulator-always-on;
				meizu,gpu-normal-on;
			};
			m86_ldo10_g3d_m: LDO10 {
				regulator-name = "vdd_g3d_m";
				regulator-min-microvolt = <800000>;
				regulator-max-microvolt = <800000>;
				regulator-always-on;
			};
			/*
			 * Board LDOs. These constraints can write the voltage
			 * at probe if the firmware setting differs.
			 */
			m86_wm8998_1v8: LDO16 {
				regulator-name = "vdd18_audio";
				regulator-min-microvolt = <1800000>;
				regulator-max-microvolt = <1800000>;
				regulator-boot-on;
				regulator-always-on;
			};
			ldo17_reg: LDO17 {
				regulator-name = "vdd28_sen";
				regulator-min-microvolt = <2800000>;
				regulator-max-microvolt = <2800000>;
				regulator-boot-on;
				regulator-always-on;
			};
			m86_lcd_1v8: LDO18 {
				regulator-name = "vdd18_lcd";
				regulator-min-microvolt = <1800000>;
				regulator-max-microvolt = <1800000>;
				regulator-boot-on;
				regulator-always-on;
			};
			m86_lcd_3v3: LDO19 {
				regulator-name = "vdd33_lcd";
				regulator-min-microvolt = <3300000>;
				regulator-max-microvolt = <3300000>;
				regulator-boot-on;
				regulator-always-on;
			};
			m86_touch_3v3: LDO21 {
				regulator-name = "vdd33_touch";
				regulator-min-microvolt = <2900000>;
				regulator-max-microvolt = <2900000>;
				regulator-boot-on;
				regulator-always-on;
			};
			m86_es705_1v1: LDO22 {
				regulator-name = "vdd11_nr";
				regulator-min-microvolt = <1100000>;
				regulator-max-microvolt = <1100000>;
			};
			m86_touch_1v8: LDO23 {
				regulator-name = "vdd18_touch";
				regulator-min-microvolt = <1800000>;
				regulator-max-microvolt = <1800000>;
				regulator-boot-on;
				regulator-always-on;
			};
			ldo25_reg: LDO25 {
				regulator-name = "vdd28_ps";
				regulator-min-microvolt = <2800000>;
				regulator-max-microvolt = <2800000>;
			};
			ldo14_reg: LDO14 {
				regulator-name = "vdd28_fp";
				regulator-min-microvolt = <1800000>;
				regulator-max-microvolt = <1800000>;
				regulator-boot-on;
				regulator-always-on;
			};
			ldo2_reg: LDO2 {
				regulator-name = "vqmmc_sdcard";
				regulator-min-microvolt = <1800000>;
				regulator-max-microvolt = <3300000>;
				regulator-boot-on;
			};
			ldo27_reg: LDO27 {
				regulator-name = "vdd18_nfc";
				regulator-min-microvolt = <1800000>;
				regulator-max-microvolt = <1800000>;
				regulator-boot-on;
				regulator-always-on;
			};
			ldo15_reg: LDO15 {
				regulator-name = "vdd18_bcam";
				regulator-min-microvolt = <1800000>;
				regulator-max-microvolt = <1800000>;
			};
			ldo20_reg: LDO20 {
				regulator-name = "vdd18_fcam";
				regulator-min-microvolt = <1800000>;
				regulator-max-microvolt = <1800000>;
			};
			ldo24_reg: LDO24 {
				regulator-name = "avdd28_drv";
				regulator-min-microvolt = <2800000>;
				regulator-max-microvolt = <2800000>;
			};
			ldo26_reg: LDO26 {
				regulator-name = "vdd11_bcam";
				regulator-min-microvolt = <1150000>;
				regulator-max-microvolt = <1150000>;
			};
		};
	};
};

&hsi2c_6 {
	status = "okay";
	clock-frequency = <100000>;

	m86_gauge: gauge@55 {
		compatible = "meizu,m86-bq27532-readonly";
		reg = <0x55>;
	};

	m86_secondary_charger: charger@6b {
		compatible = "meizu,m86-bq25892", "ti,bq25892", "ti,bq25890";
		reg = <0x6b>;
		interrupt-parent = <&gpa0>;
		interrupts = <2 IRQ_TYPE_EDGE_FALLING>;
		enable-gpios = <&gpr3 2 GPIO_ACTIVE_LOW>;
		linux,skip-reset;
		ti,charge-current = <2250000>;
		ti,battery-regulation-voltage = <4352000>;
		ti,termination-current = <64000>;
		ti,precharge-current = <128000>;
		ti,minimum-sys-voltage = <3500000>;
		ti,boost-voltage = <5000000>;
		ti,boost-max-current = <500000>;
		ti,thermal-regulation-threshold = <80>;
		meizu,secondary-charger;
	};
};

&hsi2c_7 {
	status = "okay";
	clock-frequency = <400000>;

	audio_pa_tfa9890: audio-codec@34 {
		compatible = "nxp,tfa9890";
		reg = <0x34>;
		vddd-supply = <&m86_wm8998_1v8>;
		reset-gpios = <&gpf3 1 GPIO_ACTIVE_HIGH>;
		#sound-dai-cells = <0>;
	};

	ess9018k2m: ess9018k2m@48 {
		compatible = "ess,ess9018k2m";
		reg = <0x48>;
		osc48k-gpios = <&gpf2 1 GPIO_ACTIVE_HIGH>;
		osc44k-gpios = <&gpf2 3 GPIO_ACTIVE_HIGH>;
		reset-gpios = <&gpf0 4 GPIO_ACTIVE_HIGH>;
		mute-gpios = <&gpf1 3 GPIO_ACTIVE_HIGH>;
		open-gpios = <&gpf5 0 GPIO_ACTIVE_HIGH>;
		low-gain-gpios = <&gpf1 0 GPIO_ACTIVE_HIGH>;
		out-select-gpios = <&gpf1 4 GPIO_ACTIVE_HIGH>;
		dvdd18-gpios = <&gpf4 1 GPIO_ACTIVE_HIGH>;
		#sound-dai-cells = <0>;
	};
};

&hsi2c_8 {
	status = "okay";
	clock-frequency = <400000>;

	m86_fusb302: typec-portc@22 {
		compatible = "fcs,fusb302";
		reg = <0x22>;
		interrupt-parent = <&gpa1>;
		interrupts = <5 IRQ_TYPE_LEVEL_LOW>;
		pd-on-gpios = <&gpr3 4 GPIO_ACTIVE_HIGH>;
		pinctrl-names = "default";
		pinctrl-0 = <&ccd_int>;
		vbus-supply = <&usb_otg_vbus>;

		connector {
			compatible = "usb-c-connector";
			label = "USB-C";
			power-role = "dual";
			data-role = "dual";
			/*
			 * FUSB302 is PD 2.0 silicon: a PD 3.0 Get_Source_Cap_Extended
			 * from a PD 3.0 host ends in a Hard Reset loop every ~1.2 s.
			 */
			pd-revision = /bits/ 8 <0x2 0x0 0x1 0x3>;
			source-pdos = <PDO_FIXED(5000, 1500, PDO_FIXED_USB_COMM)>;
			sink-pdos = <
				PDO_FIXED(5000, 3000, PDO_FIXED_USB_COMM)
				PDO_FIXED(9000, 3000, PDO_FIXED_USB_COMM)
				PDO_FIXED(12000, 2000, PDO_FIXED_USB_COMM)
			>;
			op-sink-microwatt = <24000000>;
			usb-role-switch = <&m86_dwc3>;

			ports {
				#address-cells = <1>;
				#size-cells = <0>;

				port@0 {
					reg = <0>;
					usbc_hs: endpoint {
						remote-endpoint = <&dwc3_ep>;
					};
				};
			};
		};
	};

	m86_muic: muic@25 {
		compatible = "meizu,m86-tsu6721";
		reg = <0x25>;
	};
};

&hsi2c_9 {
	status = "okay";
	clock-frequency = <200000>;

	nfc@28 {
		compatible = "nxp,nxp-nci-i2c";
		reg = <0x28>;
		interrupt-parent = <&gpa2>;
		interrupts = <1 IRQ_TYPE_LEVEL_HIGH>;
		enable-gpios = <&gpc3 0 GPIO_ACTIVE_HIGH>;
		firmware-gpios = <&gpc3 4 GPIO_ACTIVE_HIGH>;
		pinctrl-names = "default";
		pinctrl-0 = <&nfc_int_pin &nfc_ctrl_pins>;
	};
};

&hsi2c_10 {
	status = "okay";
	clock-frequency = <400000>;

	light-sensor@44 {
		compatible = "intersil,isl29125";
		reg = <0x44>;
		interrupt-parent = <&gpa2>;
		interrupts = <5 IRQ_TYPE_EDGE_FALLING>;
		pinctrl-names = "default";
		pinctrl-0 = <&als_irq_pins>;
		vdd-supply = <&ldo17_reg>;
		meizu,lux-coef = <16399>;
	};

	proximity-sensor@1e {
		compatible = "txc,pa224";
		reg = <0x1e>;
		interrupt-parent = <&gpa3>;
		interrupts = <4 IRQ_TYPE_EDGE_FALLING>;
		pinctrl-names = "default";
		pinctrl-0 = <&ps_irq_pins>;
		vdd-supply = <&ldo17_reg>;
		vdd-led-supply = <&ldo25_reg>;
	};
};

&hsi2c_11 {
	status = "okay";
	clock-frequency = <100000>;

	m86_primary_charger: charger@6b {
		compatible = "meizu,m86-bq25892", "ti,bq25892", "ti,bq25890";
		reg = <0x6b>;
		interrupt-parent = <&gpa0>;
		interrupts = <3 IRQ_TYPE_EDGE_FALLING>;
		enable-gpios = <&gpr3 0 GPIO_ACTIVE_LOW>;
		linux,skip-reset;
		ti,charge-current = <2250000>;
		ti,battery-regulation-voltage = <4352000>;
		ti,termination-current = <64000>;
		ti,precharge-current = <128000>;
		ti,minimum-sys-voltage = <3500000>;
		ti,boost-voltage = <5000000>;
		ti,boost-max-current = <1500000>;
		ti,thermal-regulation-threshold = <80>;
		meizu,battery = <&m86_gauge>;
		meizu,usb-source = <&m86_fusb302>;
		linux,secondary-charger-name = "m86-charger-aux";

		usb_otg_vbus: usb-otg-vbus {
			regulator-name = "usb_otg_vbus";
		};
	};
};

&i2s0 {
	status = "okay";
	pinctrl-names = "default";
	pinctrl-0 = <&i2s0_bus>;
};

&i2s1 {
	status = "okay";
};

&mfc {
	memory-region = <&mfc_iova_resv>;
	status = "okay";
};

&mmc_2 {
	status = "okay";
	num-slots = <1>;
	cap-sd-highspeed;
	sd-uhs-sdr12;
	sd-uhs-sdr25;
	sd-uhs-sdr50;
	sd-uhs-sdr104;
	sd-uhs-ddr50;
	card-detect-delay = <200>;
	samsung,dw-mshc-ciu-div = <3>;
	samsung,dw-mshc-sdr-timing = <3 0 3 2>;
	samsung,dw-mshc-ddr-timing = <3 0 2 1>;
	fifo-depth = <0x40>;
	bus-width = <4>;
	cd-gpios = <&gpa1 3 GPIO_ACTIVE_LOW>;
	vmmc-supply = <&dvdd29_tf>;
	vqmmc-supply = <&ldo2_reg>;
	pinctrl-names = "default";
	pinctrl-0 = <&sd2_clk &sd2_cmd &sd2_bus1 &sd2_bus4 &m86_sd2_cd>;
};

&pd_g3d {
	status = "okay";
};

&pdma0 {
	status = "okay";
};

&pdma1 {
	status = "okay";
};

&pinctrl_alive {
	ccd_int: ccd-int-pins {
		samsung,pins = "gpa1-5";
		samsung,pin-function = <0xf>;
		samsung,pin-pud = <0>;
	};

	m86_touch_irq_pin: m86-touch-irq-pins {
		samsung,pins = "gpa1-1";
		samsung,pin-function = <0xf>;
		samsung,pin-pud = <3>;
	};

	m86_keys_pins: m86-keys-pins {
		samsung,pins = "gpa2-4", "gpa1-2", "gpa0-7", "gpa3-2";
		samsung,pin-function = <0xf>;
		samsung,pin-pud = <0>;
	};

	als_irq_pins: als-irq-pins {
		samsung,pins = "gpa2-5";
		samsung,pin-function = <0xf>;
		samsung,pin-pud = <3>;
		samsung,pin-drv = <0>;
	};

	ps_irq_pins: ps-irq-pins {
		samsung,pins = "gpa3-4";
		samsung,pin-function = <0xf>;
		samsung,pin-pud = <3>;
		samsung,pin-drv = <0>;
	};

	fpc_irq_pin: fpc-irq-pins {
		samsung,pins = "gpa2-2";
		samsung,pin-function = <0xf>;
		samsung,pin-pud = <0>;
	};

	m86_sd2_cd: sd2-cd-pins {
		samsung,pins = "gpa1-3";
		samsung,pin-function = <0xf>;
		samsung,pin-pud = <3>;
	};

	nfc_int_pin: nfc-int-pins {
		samsung,pins = "gpa2-1";
		samsung,pin-function = <0xf>;
		samsung,pin-pud = <1>;
	};

	pro5_pcie_clock_request_pins: pro5-pcie-clock-request-pins {
		samsung,pins = "gpa3-5";
		samsung,pin-function = <0xf>;
		samsung,pin-pud = <0>;
	};

	pro5_pcie_wake_pins: pro5-pcie-wake-pins {
		samsung,pins = "gpa3-3";
		samsung,pin-function = <0>;
		samsung,pin-pud = <0>;
	};

	bt_hostwake: bt-hostwake-pins {
		samsung,pins = "gpa2-6";
		samsung,pin-function = <EXYNOS_PIN_FUNC_EINT>;
		samsung,pin-pud = <EXYNOS_PIN_PULL_DOWN>;
		samsung,pin-drv = <EXYNOS7_PIN_DRV_LV1>;
	};

	cwmcu_irq_pin: cwmcu-irq-pins {
		samsung,pins = "gpa1-7";
		samsung,pin-function = <0xf>;
		samsung,pin-pud = <3>;
		samsung,pin-drv = <0>;
	};
};

&pinctrl_aud {
	status = "okay";
};

&pinctrl_bus0 {
	/*
	 * Vendor disp_teson: GPG0-1 function 2 routes the hardware TE input.
	 * Not selected: DECON triggers from the gpc0-1 TE EINT, as during the
	 * bootloader handoff.
	 */
	m86_hw_te_on: m86-hw-te-on-pins {
		samsung,pins = "gpg0-1";
		samsung,pin-function = <2>;
	};

	nfc_ctrl_pins: nfc-ctrl-pins {
		samsung,pins = "gpc3-0", "gpc3-4", "gpc3-7";
		samsung,pin-function = <1>;
		samsung,pin-pud = <0>;
		samsung,pin-con-pdn = <3>;
	};

	vl6180_i2c_pins: vl6180-i2c-pins {
		samsung,pins = "gpc2-2", "gpc2-3";
		samsung,pin-function = <0>;
		samsung,pin-pud = <3>;
		samsung,pin-drv = <0>;
	};

	vl6180_en_pin: vl6180-en-pins {
		samsung,pins = "gpd7-2";
		samsung,pin-function = <1>;
		samsung,pin-pud = <0>;
		samsung,pin-drv = <0>;
	};

	vl6180_irq_pin: vl6180-irq-pins {
		samsung,pins = "gpc3-6";
		samsung,pin-function = <0>;
		samsung,pin-pud = <3>;
		samsung,pin-drv = <0>;
	};

	lm3644_i2c_pins: lm3644-i2c-pins {
		samsung,pins = "gpc2-4", "gpc2-5";
		samsung,pin-function = <0>;
		samsung,pin-pud = <3>;
		samsung,pin-drv = <0>;
	};

	lm3644_ctrl_pins: lm3644-ctrl-pins {
		samsung,pins = "gpc0-0", "gpc0-3", "gpc0-4";
		samsung,pin-function = <0>;
		samsung,pin-pud = <0>;
		samsung,pin-drv = <0>;
	};
};

&pinctrl_bus1 {
	pro5_pcie_gpio_pins: pro5-pcie-gpio-pins {
		samsung,pins = "gpf5-6", "gpg2-0";
		samsung,pin-function = <1>;
		samsung,pin-drv = <3>;
	};

	pro5_pcie_clkreq_pins: pro5-pcie-clkreq-pins {
		samsung,pins = "gpf0-6";
		samsung,pin-function = <2>;
		samsung,pin-pud = <0>;
		samsung,pin-drv = <3>;
	};

	pro5_pcie_reset_clear_pins: pro5-pcie-reset-clear-pins {
		samsung,pins = "gpg2-2";
		samsung,pin-function = <2>;
		samsung,pin-pud = <3>;
	};

	bt_ctrl: bt-ctrl-pins {
		samsung,pins = "gpf5-7", "gpf4-0";
		samsung,pin-function = <EXYNOS_PIN_FUNC_OUTPUT>;
		samsung,pin-pud = <EXYNOS_PIN_PULL_NONE>;
		samsung,pin-drv = <EXYNOS7_PIN_DRV_LV1>;
	};

	cwmcu_wkup_pin: cwmcu-wkup-pins {
		samsung,pins = "gpf3-3";
		samsung,pin-function = <1>;
		samsung,pin-pud = <1>;
		samsung,pin-drv = <0>;
	};

	cwmcu_in_pins: cwmcu-in-pins {
		samsung,pins = "gpf0-2", "gpf4-5";
		samsung,pin-function = <0>;
		samsung,pin-pud = <1>;
		samsung,pin-drv = <0>;
	};

	motor_en_pin: motor-en-pins {
		samsung,pins = "gpf1-1";
		samsung,pin-function = <1>;
		samsung,pin-pud = <0>;
		samsung,pin-drv = <0>;
	};

	lp5562_i2c_pins: lp5562-i2c-pins {
		samsung,pins = "gpf1-6", "gpf1-7";
		samsung,pin-function = <0>;
		samsung,pin-pud = <3>;
		samsung,pin-drv = <0>;
	};

	lp5562_en_pin: lp5562-en-pins {
		samsung,pins = "gpf5-4";
		samsung,pin-function = <1>;
		samsung,pin-pud = <0>;
		samsung,pin-drv = <0>;
	};
};

&pinctrl_ese {
	fpc_rst_pin: fpc-rst-pins {
		samsung,pins = "gpv7-4";
		samsung,pin-function = <1>;
		samsung,pin-pud = <0>;
	};

	/* SPI4 CLK/MISO/MOSI only: nCS (gpv7-1) is a GPIO, see &spi_4. */
	m86_spi4_bus: m86-spi4-bus-pins {
		samsung,pins = "gpv7-0", "gpv7-2", "gpv7-3";
		samsung,pin-function = <2>;
		samsung,pin-pud = <3>;
	};

	m86_spi4_cs: m86-spi4-cs-pins {
		samsung,pins = "gpv7-1";
		samsung,pin-function = <1>;
		samsung,pin-pud = <3>;
	};
};

&pinctrl_ff {
	spi3_cs: spi3-cs-pins {
		samsung,pins = "gpg4-1";
		samsung,pin-function = <EXYNOS_PIN_FUNC_OUTPUT>;
		samsung,pin-pud = <EXYNOS_PIN_PULL_UP>;
		samsung,pin-drv = <EXYNOS7_PIN_DRV_LV1>;
	};
};

&pinctrl_fsys1 {
	cwmcu_ctrl_pins: cwmcu-ctrl-pins {
		samsung,pins = "gpr0-0", "gpr0-2";
		samsung,pin-function = <1>;
		samsung,pin-pud = <1>;
		samsung,pin-drv = <0>;
	};
};

&pmu_system_controller {
	#clock-cells = <1>;
	clock-names = "clkout16";
	clocks = <&fin_pll>;
	assigned-clocks = <&pmu_system_controller 0>;
	assigned-clock-parents = <&fin_pll>;

	/*
	 * S-Boot reads SYSIP_DAT0 after SWRESET (vendor common.c
	 * exynos_restart()). Only the modes S-Boot was seen to honour are
	 * listed; 0xfe ("bootloader") leaves it stuck at the boot logo.
	 */
	reboot-mode {
		compatible = "syscon-reboot-mode";
		offset = <0x810>; /* SYSIP_DAT0 */
		mode-normal = <0x00>;
		mode-fastboot = <0xfc>;
		mode-recovery = <0xff>;
	};
};

&pwm {
	status = "disabled";
};

/*
 * SoC RTC alarm (GIC SPI 355) is the only RTC wake source: the S2MPS15 IRQ
 * line is not wired in this DT. rtc-s3c also exports RTCCON CLKOUTEN[9] as a
 * CCF clock provider consumed by WM8998 (mclk2) and ES705 (clk32k).
 */
&rtc {
	clocks = <&clock_ccore PCLK_RTC>, <&m86_rtc_32k>;
	clock-names = "rtc", "rtc_src";
	#clock-cells = <0>;
	clock-output-names = "rtc_clkout";
	samsung,pmu-syscon = <&pmu_system_controller>;
	status = "okay";
};

&serial_2 {
	pinctrl-names = "default";
	pinctrl-0 = <&uart2_data>;
	status = "okay";
};

&serial_4 {
	status = "okay";
	pinctrl-names = "default";
	pinctrl-0 = <&uart4_bus &bt_ctrl &bt_hostwake>;
	samsung,uart-fifosize = <64>;

	bluetooth {
		compatible = "brcm,bcm4345c5";
		max-speed = <1500000>;
		shutdown-gpios = <&gpf5 7 GPIO_ACTIVE_HIGH>;
		device-wakeup-gpios = <&gpf4 0 GPIO_ACTIVE_HIGH>;
		interrupt-parent = <&gpa2>;
		interrupts = <6 IRQ_TYPE_EDGE_RISING>;
		interrupt-names = "host-wakeup";
	};
};

&soc {
	/* Preserve SoC MMIO and translate the channel-1 PCIe outbound aperture. */
	ranges = <0x00000000 0x0 0x00000000 0x18000000>,
		 <0x1c000000 0x0 0x1c000000 0x04000000>;

	/* This word lies outside clock_fsys1's existing 0xd00 range. */
	pro5_pcie_cmu_control: syscon@156e0f00 {
		compatible = "samsung,exynos7420-pcie-cmu-control", "syscon";
		reg = <0x156e0f00 4>;
	};

	pro5_pcie1: pcie@15660000 {
		compatible = "samsung,exynos7420-pro5-pcie-enumeration";
		reg = <0x15660000 0x1000>, <0x15630000 0x1000>,
		      <0x156f00e4 4>, <0x157b0000 0x1000>,
		      <0x1c000000 0x1000>;
		reg-names = "elbi", "phy", "pcs", "dbi", "config";
		samsung,pcie-sysreg = <&sysreg 0x265c>;
		samsung,pmu-syscon = <&pmu_system_controller>;
		samsung,pcie-cmu-control = <&pro5_pcie_cmu_control>;
		device_type = "pci";
		#address-cells = <3>;
		#size-cells = <2>;
		bus-range = <0 255>;
		/* Inbound identity DMA aperture for the installed 3GB DRAM. */
		dma-ranges = <0x02000000 0 0x40000000 0x40000000 0 0xc0000000>;
		ranges = <0x82000000 0 0x1c011000 0x1c011000 0 0x03feefff>;
		num-lanes = <1>;
		max-link-speed = <1>;
		/* Interrupts are masked by the enumeration-only driver. */
		interrupts = <GIC_SPI 205 IRQ_TYPE_LEVEL_HIGH>;
		interrupt-names = "elbi";
		reset-gpios = <&gpg2 0 GPIO_ACTIVE_LOW>;
		reg-on-gpios = <&gpf5 6 GPIO_ACTIVE_HIGH>;
		pinctrl-names = "default";
		pinctrl-0 = <&pro5_pcie_gpio_pins &pro5_pcie_clkreq_pins
			     &pro5_pcie_reset_clear_pins &pro5_pcie_wake_pins
			     &pro5_pcie_clock_request_pins>;
		/* The driver selects the four mux parents itself after stage0. */
		clocks = <&clock_fsys1 ACLK_XIU_WIFI1X>,
			 <&clock_fsys1 ACLK_AHB2AXI_PCIE_WIFI1>,
			 <&clock_fsys1 ACLK_PCIE_WIFI1_MSTR>,
			 <&clock_fsys1 ACLK_PCIE_WIFI1_SLV>,
			 <&clock_fsys1 ACLK_PCIE_WIFI1_DBI>,
			 <&clock_fsys1 ACLK_COMBO_PHY_PCS_WIFI1>,
			 <&clock_fsys1 PCLK_ASYNC_COMBO_PHY_WIFI1>,
			 <&clock_fsys1 SCLK_PCIE_LINK_WIFI1>,
			 <&clock_fsys1 SCLK_COMBO_PHY_WIFI1_26M>,
			 <&clock_fsys1 SCLK_PHY_FSYS1_USER>,
			 <&clock_fsys1 PHYCLK_PCIE_WIFI1_TX0_USER>,
			 <&clock_fsys1 PHYCLK_PCIE_WIFI1_RX0_USER>,
			 <&clock_fsys1 MOUT_FSYS1_PHYCLK_SEL0>,
			 <&clock_fsys1 MOUT_PHYCLK_PCIE_WIFI1_TX0_USER>,
			 <&clock_fsys1 MOUT_PHYCLK_PCIE_WIFI1_RX0_USER>,
			 <&clock_fsys1 MOUT_SCLK_PHY_FSYS1_USER>,
			 <&fin_pll>, <&clock_fsys1 PHYCLK_PCIE_WIFI1_TX0>,
			 <&clock_fsys1 PHYCLK_PCIE_WIFI1_RX0>,
			 <&clock_top1 CLK_SCLK_PHY_FSYS1>;
		clock-names = "aclk_xiu_wifi1x", "aclk_ahb2axi_pcie_wifi1",
			      "aclk_pcie_wifi1_mstr_aclk", "aclk_pcie_wifi1_slv_aclk",
			      "aclk_pcie_wifi1_dbi_aclk", "aclk_combo_phy_pcs_pclk_wifi1",
			      "pclk_async_combo_phy_wifi1", "sclk_pcie_link_wifi1_gated",
			      "sclk_combo_phy_wifi1_26m_gated", "sclk_phy_fsys1_gated",
			      "phyclk_pcie_wifi1_tx0_gated", "phyclk_pcie_wifi1_rx0_gated",
			      "combo-ref-mux", "phy-tx-mux", "phy-rx-mux", "phy-user-mux",
			      "combo-ref-parent", "phy-tx-parent", "phy-rx-parent", "phy-user-parent";
		status = "okay";
	};
};

&spi_3 {
	status = "okay";
	pinctrl-names = "default";
	pinctrl-0 = <&spi3_bus &spi3_cs>;
	cs-gpios = <&gpg4 1 GPIO_ACTIVE_LOW>;
	num-cs = <1>;

	es705: audio-dsp@0 {
		compatible = "audience,es705";
		reg = <0>;
		spi-max-frequency = <4000000>;
		spi-cpha;
		clocks = <&pmu_system_controller 0>, <&rtc>;
		clock-names = "mclk", "clk32k";
		vdd-core-supply = <&m86_es705_1v1>;
		reset-gpios = <&gpf5 5 GPIO_ACTIVE_HIGH>;
		wakeup-gpios = <&gpd5 1 GPIO_ACTIVE_HIGH>;
		#sound-dai-cells = <1>;

		controller-data {
			samsung,spi-feedback-delay = <0>;
		};
	};
};

/*
 * Fingerprint sensor bus (vendor DT: secure-mode). Normal-world access
 * verified with diagnostics/kmods/m86-spi4-probe and m86-fpc-hwid: the
 * sensor reports HWID 0x150b (FPC1150 rev B).
 */
&spi_4 {
	status = "okay";
	/* Vendor 3.10 drives nCS manually; CS_AUTO read back MISO as 0. */
	pinctrl-0 = <&m86_spi4_bus &m86_spi4_cs>;
	cs-gpios = <&gpv7 1 GPIO_ACTIVE_LOW>;

	fpc_spi: fingerprint@0 {
		compatible = "fpc,fpc1150";
		reg = <0>;
		spi-max-frequency = <4800000>;
	};
};

&sysmmu_disp_ro {
	status = "okay";
};

&sysmmu_disp_rw {
	status = "okay";
};

&sysmmu_mfc_0 {
	status = "okay";
};

&sysmmu_mfc_1 {
	status = "okay";
};

&sysmmu_cam0 {
	status = "okay";
};

&ufs {
	samsung,bus = <&bus_mif>;
	interconnects = <&bus_int &bus_mif>;
	interconnect-names = "dma-mem";
	status = "okay";
};

&usbdrd {
	status = "okay";

	m86_dwc3: usb@0 {
		dr_mode = "otg";
		usb-role-switch;
		role-switch-default-mode = "peripheral";
		maximum-speed = "high-speed";
		snps,dis_u2_susphy_quirk;
		snps,dis_enblslpm_quirk;

		port {
			dwc3_ep: endpoint {
				remote-endpoint = <&usbc_hs>;
			};
		};
	};
};

&usbdrd_phy {
	status = "okay";
};

&watchdog {
	status = "okay";
};

/*
 * Cameras: rear Sony IMX230 (4-lane CSIS0 -> FIMC-BNS-A) and front OmniVision
 * OV5670 (2-lane CSIS1 -> FIMC-BNS-B). Raw Bayer only; the FIMC-IS ISP and its
 * Cortex-A5 firmware are not used. Rails, resets and buses follow the vendor
 * 3.10 fimc-is-device-imx230.c/ov5670.c power tables.
 */
/ {
	bcam_vcm: regulator-dvdd20-vcm {
		compatible = "regulator-fixed";
		regulator-name = "dvdd20_vcm";
		regulator-min-microvolt = <2000000>;
		regulator-max-microvolt = <2000000>;
		gpio = <&gpc3 1 GPIO_ACTIVE_HIGH>;
		enable-active-high;
	};

	bcam_vana: regulator-vcc25-bcam {
		compatible = "regulator-fixed";
		regulator-name = "vcc25_bcam";
		regulator-min-microvolt = <2500000>;
		regulator-max-microvolt = <2500000>;
		gpio = <&gpc0 5 GPIO_ACTIVE_HIGH>;
		enable-active-high;
	};

	fcam_vana: regulator-vcc28-fcam {
		compatible = "regulator-fixed";
		regulator-name = "vcc28_fcam";
		regulator-min-microvolt = <2800000>;
		regulator-max-microvolt = <2800000>;
		gpio = <&gpc0 6 GPIO_ACTIVE_HIGH>;
		enable-active-high;
	};

	fcam_vdig: regulator-vdd12-fcam {
		compatible = "regulator-fixed";
		regulator-name = "vdd12_fcam";
		regulator-min-microvolt = <1200000>;
		regulator-max-microvolt = <1200000>;
		gpio = <&gpc3 5 GPIO_ACTIVE_HIGH>;
		enable-active-high;
	};

	i2c_bcam: i2c-bcam {
		compatible = "i2c-gpio";
		sda-gpios = <&gpc2 0 (GPIO_ACTIVE_HIGH | GPIO_OPEN_DRAIN)>;
		scl-gpios = <&gpc2 1 (GPIO_ACTIVE_HIGH | GPIO_OPEN_DRAIN)>;
		i2c-gpio,delay-us = <2>;
		pinctrl-names = "default";
		pinctrl-0 = <&bcam_i2c_pins>;
		#address-cells = <1>;
		#size-cells = <0>;

		camera@1a {
			compatible = "sony,imx230";
			reg = <0x1a>;
			clocks = <&clock_top0 CLK_SCLK_ISP_SENSOR0>;
			clock-frequency = <24000000>;
			vana-supply = <&bcam_vana>;
			vdig-supply = <&ldo26_reg>;
			vif-supply = <&ldo15_reg>;
			vcm-supply = <&bcam_vcm>;
			vdrv-supply = <&ldo24_reg>;
			reset-gpios = <&gpc1 1 GPIO_ACTIVE_LOW>;
			orientation = <1>;
			rotation = <0>;
			pinctrl-names = "default";
			pinctrl-0 = <&bcam_mclk_pin &bcam_ctrl_pins &bcam_xbootldo_pin>;

			port {
				imx230_out: endpoint {
					remote-endpoint = <&csis0_in>;
					data-lanes = <1 2 3 4>;
					link-frequencies = /bits/ 64 <240000000 699428571
									 360000000 199714286>;
				};
			};
		};
	};
};

&i2c_fcam {
	camera@36 {
		compatible = "ovti,ov5670";
		reg = <0x36>;
		clocks = <&clock_top0 CLK_SCLK_ISP_SENSOR1>;
		clock-frequency = <24000000>;
		avdd-supply = <&fcam_vana>;
		dvdd-supply = <&fcam_vdig>;
		dovdd-supply = <&ldo20_reg>;
		vcm-supply = <&bcam_vcm>;
		vdrv-supply = <&ldo24_reg>;
		reset-gpios = <&gpc0 7 GPIO_ACTIVE_LOW>;
		orientation = <0>;
		rotation = <0>;
		pinctrl-names = "default";
		pinctrl-0 = <&fcam_mclk_pin &fcam_ctrl_pins>;

		port {
			ov5670_out: endpoint {
				remote-endpoint = <&csis1_in>;
				data-lanes = <1 2>;
				link-frequencies = /bits/ 64 <432000000>;
			};
		};
	};
};

&pinctrl_bus0 {
	bcam_i2c_pins: bcam-i2c-pins {
		samsung,pins = "gpc2-0", "gpc2-1";
		samsung,pin-function = <0>;
		samsung,pin-pud = <3>;
		samsung,pin-drv = <0>;
	};

	bcam_mclk_pin: bcam-mclk-pins {
		samsung,pins = "gpd7-0";
		samsung,pin-function = <2>;	/* CIS_CLK0 */
		samsung,pin-pud = <0>;
		samsung,pin-drv = <3>;
	};

	fcam_mclk_pin: fcam-mclk-pins {
		samsung,pins = "gpd7-1";
		samsung,pin-function = <2>;	/* CIS_CLK1 */
		samsung,pin-pud = <0>;
		samsung,pin-drv = <3>;
	};

	bcam_ctrl_pins: bcam-ctrl-pins {
		samsung,pins = "gpc1-1", "gpc0-5", "gpc3-1";
		samsung,pin-function = <1>;
		samsung,pin-pud = <0>;
		samsung,pin-drv = <0>;
	};

	fcam_ctrl_pins: fcam-ctrl-pins {
		samsung,pins = "gpc0-7", "gpc0-6", "gpc3-5";
		samsung,pin-function = <1>;
		samsung,pin-pud = <0>;
		samsung,pin-drv = <0>;
	};
};

&pinctrl_bus1 {
	bcam_xbootldo_pin: bcam-xbootldo-pins {
		samsung,pins = "gpv6-2";
		samsung,pin-function = <1>;
		samsung,pin-pud = <0>;
		samsung,pin-drv = <0>;
		samsung,pin-val = <1>;
	};
};

/*
 * Feed the CAM0 aclks from the running CC_PLL/2 (532 MHz, as CAM0 TREX)
 * instead of ISP_PLL/CAM_PLL, which are disabled at boot, and ensure
 * CIS_CLK0/CIS_CLK1 muxes select the 24 MHz fin_pll parent (selector 3).
 */
&clock_top0 {
	assigned-clocks = <&clock_top0 CLK_MOUT_ACLK_CAM0_CSIS0_690>,
			  <&clock_top0 CLK_MOUT_ACLK_CAM0_BNSA_690>,
			  <&clock_top0 CLK_MOUT_ACLK_CAM0_BNSB_690>,
			  <&clock_top0 CLK_MOUT_ACLK_CAM0_CSIS1_174>,
			  <&clock_top0 CLK_MOUT_ACLK_CAM0_3AA0_690>,
			  <&clock_top0 CLK_MOUT_ACLK_CAM0_3AA1_468>,
			  <&clock_top0 CLK_MOUT_SCLK_ISP_SENSOR0>,
			  <&clock_top0 CLK_MOUT_SCLK_ISP_SENSOR1>;
	assigned-clock-parents = <&clock_top0 CLK_MOUT_TOP0_CC_PLL_HALF>,
				 <&clock_top0 CLK_MOUT_TOP0_CC_PLL_HALF>,
				 <&clock_top0 CLK_MOUT_TOP0_CC_PLL_HALF>,
				 <&clock_top0 CLK_MOUT_TOP0_CC_PLL_HALF>,
				 <&clock_top0 CLK_MOUT_TOP0_CC_PLL_HALF>,
				 <&clock_top0 CLK_MOUT_TOP0_CC_PLL_HALF>,
				 <&fin_pll>,
				 <&fin_pll>;
};

&clock_cam0 {
	status = "okay";
};

&mipi_csis_0 {
	phys = <&m86_dsim_phy 1>;
	phy-names = "csis";
	status = "okay";

	ports {
		#address-cells = <1>;
		#size-cells = <0>;

		port@0 {
			reg = <0>;
			csis0_in: endpoint {
				remote-endpoint = <&imx230_out>;
				data-lanes = <1 2 3 4>;
			};
		};

		port@1 {
			reg = <1>;
			csis0_out: endpoint {
				remote-endpoint = <&bns_a_in>;
			};
		};
	};
};

&mipi_csis_1 {
	phys = <&m86_dsim_phy 2>;
	phy-names = "csis";
	status = "okay";

	ports {
		#address-cells = <1>;
		#size-cells = <0>;

		port@0 {
			reg = <0>;
			csis1_in: endpoint {
				remote-endpoint = <&ov5670_out>;
				data-lanes = <1 2>;
			};
		};

		port@1 {
			reg = <1>;
			csis1_out: endpoint {
				remote-endpoint = <&bns_b_in>;
			};
		};
	};
};

&fimc_bns_a {
	status = "okay";

	port {
		bns_a_in: endpoint {
			remote-endpoint = <&csis0_out>;
		};
	};
};

&fimc_bns_b {
	status = "okay";

	port {
		bns_b_in: endpoint {
			remote-endpoint = <&csis1_out>;
		};
	};
};

/*
 * Shannon 333 (SS333) modem: CP bootloader over spi_1, IPC over MIPI-LLI
 * shared memory at 0xe1000000. Values follow the stock m86-modem-s333.dtsi.
 */
&mipi_lli {
	memory-region = <&modem_shmem>;
	modem-name = "ss333";
	status = "okay";

	modems {
		ss333 {
			scrambler = <0>;
			automode = <0>;
		};
	};
};

&mipi_lli_mphy {
	modem-name = "ss333";

	modems {
		ss333 {
			init-gear = <2 2 1>;
			shd-refclk = <1>;
		};
	};
};

&spi_1 {
	status = "okay";

	modem-boot@0 {
		compatible = "spi_boot_link";
		reg = <0>;
		spi-max-frequency = <100000>;

		controller-data {
			samsung,spi-feedback-delay = <0>;
		};
	};
};

/ {
	modem-if {
		compatible = "sec_modem,modem_pdata";
		pinctrl-names = "default";
		pinctrl-0 = <&m86_cp_on &m86_cp_reset &m86_cp_wakeup &m86_ap_status
			     &m86_pda_active &m86_phone_active &m86_ap_wakeup
			     &m86_cp_status &m86_ap_dump_noti>;

		mif,name = "ss333";
		mif,modem_net = <0>;
		mif,modem_type = <8>;
		mif,modem_attr = <0x01>;
		mif,link_types = <0x200>;
		mif,link_name = "lli";
		mif,link_attrs = <0x39>;
		mif,use_handover = <0>;
		mif,ipc_version = <50>;
		mif,num_iodevs = <16>;

		mif,gpio_cp_on = <&gpg0 0 GPIO_ACTIVE_HIGH>;
		mif,gpio_cp_reset = <&gpg1 2 GPIO_ACTIVE_HIGH>;
		mif,gpio_cp_wakeup = <&gpr3 7 GPIO_ACTIVE_HIGH>;
		mif,gpio_ap_status = <&gpr3 1 GPIO_ACTIVE_HIGH>;
		mif,gpio_pda_active = <&gpc0 2 GPIO_ACTIVE_HIGH>;
		mif,gpio_ap_dump_noti = <&gpc1 0 GPIO_ACTIVE_HIGH>;
		mif,gpio_phone_active = <&gpa1 4 GPIO_ACTIVE_HIGH>;
		mif,gpio_ap_wakeup = <&gpa0 6 GPIO_ACTIVE_HIGH>;
		mif,gpio_cp_status = <&gpa0 4 GPIO_ACTIVE_HIGH>;

		iodevs {
			io_device_0 {
				iod,name = "umts_ipc0";
				iod,id = <245>;
				iod,format = <0>;
				iod,io_type = <0>;
				iod,links = <0x200>;
				iod,attrs = <0x82>;
				iod,app = "RIL";
				iod,ul_num_buffers = <16>;
				iod,ul_buffer_size = <4096>;
				iod,dl_num_buffers = <16>;
				iod,dl_buffer_size = <4096>;
			};
			io_device_1 {
				iod,name = "umts_ipc1";
				iod,id = <246>;
				iod,format = <0>;
				iod,io_type = <0>;
				iod,links = <0x200>;
				iod,attrs = <0x82>;
				iod,app = "RIL";
				iod,ul_num_buffers = <16>;
				iod,ul_buffer_size = <4096>;
				iod,dl_num_buffers = <16>;
				iod,dl_buffer_size = <4096>;
			};
			io_device_2 {
				iod,name = "umts_rfs0";
				iod,id = <41>;
				iod,format = <1>;
				iod,io_type = <0>;
				iod,links = <0x200>;
				iod,attrs = <0x82>;
				iod,app = "RFS";
				iod,ul_num_buffers = <32>;
				iod,ul_buffer_size = <2048>;
				iod,dl_num_buffers = <32>;
				iod,dl_buffer_size = <2048>;
			};
			io_device_3 {
				iod,name = "umts_router";
				iod,id = <21>;
				iod,format = <1>;
				iod,io_type = <0>;
				iod,links = <0x200>;
				iod,attrs = <0x82>;
				iod,app = "Data Router";
				iod,ul_num_buffers = <16>;
				iod,ul_buffer_size = <2048>;
				iod,dl_num_buffers = <16>;
				iod,dl_buffer_size = <2048>;
			};
			io_device_4 {
				iod,name = "umts_dm0";
				iod,id = <81>;
				iod,format = <1>;
				iod,io_type = <0>;
				iod,links = <0x200>;
				iod,attrs = <0x82>;
				iod,app = "DIAG";
				iod,ul_num_buffers = <4>;
				iod,ul_buffer_size = <2048>;
				iod,dl_num_buffers = <128>;
				iod,dl_buffer_size = <2048>;
			};
			io_device_5 {
				iod,name = "umts_loopback";
				iod,id = <82>;
				iod,format = <1>;
				iod,io_type = <0>;
				iod,links = <0x200>;
				iod,attrs = <0x82>;
				iod,app = "LOOPBACK";
				iod,ul_num_buffers = <32>;
				iod,ul_buffer_size = <2048>;
				iod,dl_num_buffers = <256>;
				iod,dl_buffer_size = <2048>;
			};
			io_device_6 {
				iod,name = "rmnet0";
				iod,id = <1>;
				iod,format = <1>;
				iod,io_type = <1>;
				iod,links = <0x200>;
				iod,attrs = <0x82>;
				iod,app = "NET";
				iod,ul_num_buffers = <32>;
				iod,ul_buffer_size = <2048>;
				iod,dl_num_buffers = <256>;
				iod,dl_buffer_size = <2048>;
			};
			io_device_7 {
				iod,name = "rmnet1";
				iod,id = <2>;
				iod,format = <1>;
				iod,io_type = <1>;
				iod,links = <0x200>;
				iod,attrs = <0x82>;
				iod,app = "NET";
				iod,ul_num_buffers = <32>;
				iod,ul_buffer_size = <2048>;
				iod,dl_num_buffers = <256>;
				iod,dl_buffer_size = <2048>;
			};
			io_device_8 {
				iod,name = "rmnet2";
				iod,id = <3>;
				iod,format = <1>;
				iod,io_type = <1>;
				iod,links = <0x200>;
				iod,attrs = <0x82>;
				iod,app = "NET";
				iod,ul_num_buffers = <32>;
				iod,ul_buffer_size = <2048>;
				iod,dl_num_buffers = <256>;
				iod,dl_buffer_size = <2048>;
			};
			io_device_9 {
				iod,name = "rmnet3";
				iod,id = <4>;
				iod,format = <1>;
				iod,io_type = <1>;
				iod,links = <0x200>;
				iod,attrs = <0x82>;
				iod,app = "NET";
				iod,ul_num_buffers = <32>;
				iod,ul_buffer_size = <2048>;
				iod,dl_num_buffers = <256>;
				iod,dl_buffer_size = <2048>;
			};
			io_device_10 {
				iod,name = "rmnet4";
				iod,id = <5>;
				iod,format = <1>;
				iod,io_type = <1>;
				iod,links = <0x200>;
				iod,attrs = <0x82>;
				iod,app = "NET";
				iod,ul_num_buffers = <32>;
				iod,ul_buffer_size = <2048>;
				iod,dl_num_buffers = <256>;
				iod,dl_buffer_size = <2048>;
			};
			io_device_11 {
				iod,name = "rmnet5";
				iod,id = <6>;
				iod,format = <1>;
				iod,io_type = <1>;
				iod,links = <0x200>;
				iod,attrs = <0x82>;
				iod,app = "NET";
				iod,ul_num_buffers = <32>;
				iod,ul_buffer_size = <2048>;
				iod,dl_num_buffers = <256>;
				iod,dl_buffer_size = <2048>;
			};
			io_device_12 {
				iod,name = "rmnet6";
				iod,id = <7>;
				iod,format = <1>;
				iod,io_type = <1>;
				iod,links = <0x200>;
				iod,attrs = <0x82>;
				iod,app = "NET";
				iod,ul_num_buffers = <32>;
				iod,ul_buffer_size = <2048>;
				iod,dl_num_buffers = <256>;
				iod,dl_buffer_size = <2048>;
			};
			io_device_13 {
				iod,name = "rmnet7";
				iod,id = <8>;
				iod,format = <1>;
				iod,io_type = <1>;
				iod,links = <0x200>;
				iod,attrs = <0x82>;
				iod,app = "NET";
				iod,ul_num_buffers = <32>;
				iod,ul_buffer_size = <2048>;
				iod,dl_num_buffers = <256>;
				iod,dl_buffer_size = <2048>;
			};
			io_device_14 {
				iod,name = "multipdp";
				iod,id = <0>;
				iod,format = <3>;
				iod,io_type = <2>;
				iod,links = <0x200>;
				iod,attrs = <0x02>;
				iod,app = "RIL";
			};
			io_device_15 {
				iod,name = "umts_boot0";
				iod,id = <241>;
				iod,format = <4>;
				iod,io_type = <0>;
				iod,links = <0x200>;
				iod,attrs = <0x02>;
				iod,app = "CBD";
			};
		};
	};
};

&pinctrl_alive {
	m86_cp_status: cp-status-pins {
		samsung,pins = "gpa0-4";
		samsung,pin-function = <EXYNOS_PIN_FUNC_EINT>;
		samsung,pin-pud = <EXYNOS_PIN_PULL_NONE>;
	};

	m86_ap_wakeup: ap-wakeup-pins {
		samsung,pins = "gpa0-6";
		samsung,pin-function = <EXYNOS_PIN_FUNC_EINT>;
		samsung,pin-pud = <EXYNOS_PIN_PULL_NONE>;
	};

	m86_phone_active: phone-active-pins {
		samsung,pins = "gpa1-4";
		samsung,pin-function = <EXYNOS_PIN_FUNC_EINT>;
		samsung,pin-pud = <EXYNOS_PIN_PULL_NONE>;
	};
};

&pinctrl_bus0 {
	m86_pda_active: pda-active-pins {
		samsung,pins = "gpc0-2";
		samsung,pin-function = <EXYNOS_PIN_FUNC_OUTPUT>;
		samsung,pin-pud = <EXYNOS_PIN_PULL_NONE>;
		samsung,pin-val = <0>;
	};

	m86_ap_dump_noti: ap-dump-noti-pins {
		samsung,pins = "gpc1-0";
		samsung,pin-function = <EXYNOS_PIN_FUNC_INPUT>;
		samsung,pin-pud = <EXYNOS_PIN_PULL_DOWN>;
	};

	/* CP_ON and CP_RESET stay low until the modem driver powers the CP. */
	m86_cp_on: cp-on-pins {
		samsung,pins = "gpg0-0";
		samsung,pin-function = <EXYNOS_PIN_FUNC_OUTPUT>;
		samsung,pin-pud = <EXYNOS_PIN_PULL_NONE>;
		samsung,pin-val = <0>;
	};
};

&pinctrl_bus1 {
	m86_cp_reset: cp-reset-pins {
		samsung,pins = "gpg1-2";
		samsung,pin-function = <EXYNOS_PIN_FUNC_OUTPUT>;
		samsung,pin-pud = <EXYNOS_PIN_PULL_NONE>;
		samsung,pin-val = <0>;
	};
};

&pinctrl_fsys1 {
	m86_ap_status: ap-status-pins {
		samsung,pins = "gpr3-1";
		samsung,pin-function = <EXYNOS_PIN_FUNC_OUTPUT>;
		samsung,pin-pud = <EXYNOS_PIN_PULL_NONE>;
		samsung,pin-val = <0>;
	};

	m86_cp_wakeup: cp-wakeup-pins {
		samsung,pins = "gpr3-7";
		samsung,pin-function = <EXYNOS_PIN_FUNC_OUTPUT>;
		samsung,pin-pud = <EXYNOS_PIN_PULL_NONE>;
		samsung,pin-val = <0>;
	};
};
