## Documentation/devicetree/bindings/input/touchscreen/meizu,m86-fts.yaml
```yaml
# SPDX-License-Identifier: GPL-2.0-only OR BSD-2-Clause
%YAML 1.2
---
$id: http://devicetree.org/schemas/input/touchscreen/meizu,m86-fts.yaml#
$schema: http://devicetree.org/meta-schemas/core.yaml#

title: Meizu PRO 5 ST FTS 3980 touchscreen

maintainers:
  - Meizu PRO 5 developers <meizu-pro5-dev@users.noreply.github.com>

description: |
  Legacy ST FTS 3980 protocol with existing controller firmware. This initial
  board port retains bootloader-enabled power rails. It does not reconfigure
  PMIC supplies or flash controller firmware, and does not implement wakeup.

allOf:
  - $ref: touchscreen.yaml#

properties:
  compatible:
    const: meizu,m86-fts
  reg:
    maxItems: 1
  interrupts:
    maxItems: 1

required:
  - compatible
  - reg
  - interrupts
  - touchscreen-size-x
  - touchscreen-size-y

unevaluatedProperties: false
```

## drivers/clk/samsung/Kconfig
```kconfig
# SPDX-License-Identifier: GPL-2.0-only
# Recent Exynos platforms should just select COMMON_CLK_SAMSUNG:
config COMMON_CLK_SAMSUNG
	bool "Samsung Exynos clock controller support" if COMPILE_TEST
	depends on OF
	select S3C64XX_COMMON_CLK if ARM && ARCH_S3C64XX
	select S5PV210_COMMON_CLK if ARM && ARCH_S5PV210
	select EXYNOS_3250_COMMON_CLK if ARM && SOC_EXYNOS3250
	select EXYNOS_4_COMMON_CLK if ARM && ARCH_EXYNOS4
	select EXYNOS_5250_COMMON_CLK if ARM && SOC_EXYNOS5250
	select EXYNOS_5260_COMMON_CLK if ARM && SOC_EXYNOS5260
	select EXYNOS_5410_COMMON_CLK if ARM && SOC_EXYNOS5410
	select EXYNOS_5420_COMMON_CLK if ARM && SOC_EXYNOS5420
	select EXYNOS_ARM64_COMMON_CLK if ARM64 && ARCH_EXYNOS
	select TESLA_FSD_COMMON_CLK if ARM64 && ARCH_TESLA_FSD

config S3C64XX_COMMON_CLK
	bool "Samsung S3C64xx clock controller support" if COMPILE_TEST
	depends on COMMON_CLK_SAMSUNG
	help
	  Support for the clock controller present on the Samsung S3C64xx SoCs.
	  Choose Y here only if you build for this SoC.

config S5PV210_COMMON_CLK
	bool "Samsung S5Pv210 clock controller support" if COMPILE_TEST
	depends on COMMON_CLK_SAMSUNG
	help
	  Support for the clock controller present on the Samsung S5Pv210 SoCs.
	  Choose Y here only if you build for this SoC.

config EXYNOS_3250_COMMON_CLK
	bool "Samsung Exynos3250 clock controller support" if COMPILE_TEST
	depends on COMMON_CLK_SAMSUNG
	help
	  Support for the clock controller present on the Samsung
	  Exynos3250 SoCs. Choose Y here only if you build for this SoC.

config EXYNOS_4_COMMON_CLK
	bool "Samsung Exynos4 clock controller support" if COMPILE_TEST
	depends on COMMON_CLK_SAMSUNG
	help
	  Support for the clock controller present on the Samsung
	  Exynos4212 and Exynos4412 SoCs. Choose Y here only if you build for
	  this SoC.

config EXYNOS_5250_COMMON_CLK
	bool "Samsung Exynos5250 clock controller support" if COMPILE_TEST
	depends on COMMON_CLK_SAMSUNG
	help
	  Support for the clock controller present on the Samsung
	  Exynos5250 SoCs. Choose Y here only if you build for this SoC.

config EXYNOS_5260_COMMON_CLK
	bool "Samsung Exynos5260 clock controller support" if COMPILE_TEST
	depends on COMMON_CLK_SAMSUNG
	help
	  Support for the clock controller present on the Samsung
	  Exynos5260 SoCs. Choose Y here only if you build for this SoC.

config EXYNOS_5410_COMMON_CLK
	bool "Samsung Exynos5410 clock controller support" if COMPILE_TEST
	depends on COMMON_CLK_SAMSUNG
	help
	  Support for the clock controller present on the Samsung
	  Exynos5410 SoCs. Choose Y here only if you build for this SoC.

config EXYNOS_5420_COMMON_CLK
	bool "Samsung Exynos5420 clock controller support" if COMPILE_TEST
	depends on COMMON_CLK_SAMSUNG
	help
	  Support for the clock controller present on the Samsung
	  Exynos5420/Exynos5422/Exynos5800 SoCs. Choose Y here only if you
	  build for this SoC.

config EXYNOS_ARM64_COMMON_CLK
	bool "Samsung Exynos ARMv8-family clock controller support" if COMPILE_TEST
	depends on COMMON_CLK_SAMSUNG

config EXYNOS_AUDSS_CLK_CON
	tristate "Samsung Exynos AUDSS clock controller support"
	depends on COMMON_CLK_SAMSUNG
	default y if ARCH_EXYNOS
	help
	  Support for the Audio Subsystem CLKCON clock controller present
	  on some Samsung Exynos SoC variants. Choose M or Y here if you want
	  to use audio devices such as I2S, PCM, etc.

config EXYNOS_CLKOUT
	tristate "Samsung Exynos clock output driver"
	depends on COMMON_CLK_SAMSUNG
	default y if ARCH_EXYNOS
	help
	  Support for the clock output (XCLKOUT) present on some of Samsung
	  Exynos SoC variants. Usually the XCLKOUT is used to monitor the
	  status of the certains clocks from SoC, but it could also be tied to
	  other devices as an input clock.

config TESLA_FSD_COMMON_CLK
	bool "Tesla FSD clock controller support" if COMPILE_TEST
	depends on COMMON_CLK_SAMSUNG
	depends on EXYNOS_ARM64_COMMON_CLK
	help
	  Support for the clock controller present on the Tesla FSD SoC.
	  Choose Y here only if you build for this SoC.

config M86_CPU_CLOCKS
	tristate "Meizu PRO 5 CPU clocks"
	depends on EXYNOS_ARM64_COMMON_CLK && SMP
	help
	  Explicit CPU clock transitions for the two Exynos7420 clusters.

config M86_GPU_DVFS
	tristate "PRO5 retained GPU clock/MCS coordination (experimental)"
	depends on ARCH_EXYNOS && PM && PM_OPP && THERMAL && I2C && CPU_FREQ && REGULATOR && MFD_SEC_CORE
	depends on MFD_SYSCON
	select REGULATOR_M86_GPU_READONLY
	help
	  Explicit retained-domain PRO5 GPU CCF and Panfrost target transactions.
	  No probe voltage/clock writes; active voltage requires separately validated
	  BUCK6 ownership and an explicit DT flag. Keep the first ceiling266MHz.

config M86_G3D_DOMAIN_EXPERIMENT
 bool "PRO5 experimental retained-rail G3D provider"
 depends on ARCH_EXYNOS && PM_GENERIC_DOMAINS && OF
 depends on M86_GPU_DVFS=y && M86_TMU_MONITOR=y && DRM_PANFROST=y
 help
   Independent compile/integration candidate. Requires the companion clock,
   TMU, consumer idle and coordinator glue patches. No board DT enables this.
```
