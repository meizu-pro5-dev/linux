## Documentation/devicetree/bindings/cpufreq/meizu,m86-cpu-coordinator.yaml
```yaml
# SPDX-License-Identifier: GPL-2.0-only OR BSD-2-Clause
%YAML 1.2
---
$id: http://devicetree.org/schemas/cpufreq/meizu,m86-cpu-coordinator.yaml#
$schema: http://devicetree.org/meta-schemas/core.yaml#

title: Exynos7420 Dual-Cluster CPU Clock & Frequency Coordinator (Meizu PRO 5)

maintainers:
  - 404698-FDU <pro5-mainline@local>

properties:
  compatible:
    enum:
      - meizu,m86-cpu-coordinator
      - meizu,m86-atlas-clock
      - meizu,m86-apollo-clock

  reg:
    maxItems: 1

  clocks:
    minItems: 1
    maxItems: 4

  clock-names:
    minItems: 1
    maxItems: 4

  "#clock-cells":
    const: 0

  apollo-supply: true
  atlas-supply: true

  samsung,bus:
    $ref: /schemas/types.yaml#/definitions/phandle
    description: Phandle to the Exynos bus devfreq device for QoS floor voting.

  samsung,tmu:
    $ref: /schemas/types.yaml#/definitions/phandle-array
    description: Phandle list of the Exynos7420 TMU thermal nodes.

  meizu,cpu-dvfs-active:
    type: boolean
    description: Enables active dual-cluster CPU DVFS management.

  meizu,ema-syscon:
    $ref: /schemas/types.yaml#/definitions/phandle
    description: Phandle to the SRAM EMA SYSREG syscon.

  meizu,max-validated-khz:
    $ref: /schemas/types.yaml#/definitions/uint32-array
    description: Per-cluster maximum validated frequency limits in kHz.
    minItems: 2
    maxItems: 2

  meizu,max-validated-frequency:
    $ref: /schemas/types.yaml#/definitions/uint32
    description: Maximum validated cluster clock frequency in Hz.

  meizu,validated-fixed-bus-qos-floor:
    $ref: /schemas/types.yaml#/definitions/uint32
    description: Minimum fixed bus QoS floor frequency in kHz.

required:
  - compatible

additionalProperties: false
```

## Documentation/devicetree/bindings/display/panel/meizu,m86-s6e3fa3.yaml
```yaml
# SPDX-License-Identifier: GPL-2.0-only OR BSD-2-Clause
%YAML 1.2
---
$id: http://devicetree.org/schemas/display/panel/meizu,m86-s6e3fa3.yaml#
$schema: http://devicetree.org/meta-schemas/core.yaml#

title: Samsung S6E3FA3 1080p AMOLED DSI Panel on Meizu PRO 5

maintainers:
  - 404698-FDU <pro5-mainline@local>

allOf:
  - $ref: panel-common.yaml#

properties:
  compatible:
    const: meizu,m86-s6e3fa3

  reg:
    maxItems: 1

  vci-supply: true
  vdd3-supply: true
  reset-gpios: true
  port: true

required:
  - compatible
  - reg
  - port

unevaluatedProperties: false
```

## Documentation/devicetree/bindings/iio/imu/meizu,m86-cwmcu.yaml
```yaml
# SPDX-License-Identifier: GPL-2.0-only OR BSD-2-Clause
%YAML 1.2
---
$id: http://devicetree.org/schemas/iio/imu/meizu,m86-cwmcu.yaml#
$schema: http://devicetree.org/meta-schemas/core.yaml#

title: CyWee CWMCU Sensor Hub on Meizu PRO 5

maintainers:
  - 404698-FDU <pro5-mainline@local>

properties:
  compatible:
    items:
      - const: meizu,m86-cwmcu
      - const: st,sensor_hub

  reg:
    maxItems: 1

  vdd-supply: true

  interrupts:
    maxItems: 1

  wakeup-gpios:
    maxItems: 1

  sleep-gpios:
    maxItems: 1

  busy-gpios:
    maxItems: 1

  reset-gpios:
    maxItems: 1

  boot0-gpios:
    maxItems: 1

  wakeup-source: true

  mount-matrix: true

required:
  - compatible
  - reg

additionalProperties: false
```

## Documentation/devicetree/bindings/iio/light/intersil,isl29125.yaml
```yaml
# SPDX-License-Identifier: GPL-2.0-only OR BSD-2-Clause
%YAML 1.2
---
$id: http://devicetree.org/schemas/iio/light/intersil,isl29125.yaml#
$schema: http://devicetree.org/meta-schemas/core.yaml#

title: Intersil ISL29125 RGB Color Light Sensor

maintainers:
  - 404698-FDU <pro5-mainline@local>

properties:
  compatible:
    const: intersil,isl29125

  reg:
    maxItems: 1

  interrupts:
    maxItems: 1

  vdd-supply: true

  meizu,lux-coef:
    $ref: /schemas/types.yaml#/definitions/uint32
    description: Panel-specific illuminance calibration coefficient.

required:
  - compatible
  - reg

additionalProperties: false
```

## Documentation/devicetree/bindings/iio/light/txc,pa224.yaml
```yaml
# SPDX-License-Identifier: GPL-2.0-only OR BSD-2-Clause
%YAML 1.2
---
$id: http://devicetree.org/schemas/iio/light/txc,pa224.yaml#
$schema: http://devicetree.org/meta-schemas/core.yaml#

title: TXC PA224 Proximity Sensor

maintainers:
  - 404698-FDU <pro5-mainline@local>

properties:
  compatible:
    const: txc,pa224

  reg:
    maxItems: 1

  interrupts:
    maxItems: 1

  vdd-supply: true
  vdd-led-supply: true

required:
  - compatible
  - reg

additionalProperties: false
```

## Documentation/devicetree/bindings/input/meizu,m86-fpc1155.yaml
```yaml
# SPDX-License-Identifier: GPL-2.0-only OR BSD-2-Clause
%YAML 1.2
---
$id: http://devicetree.org/schemas/input/meizu,m86-fpc1155.yaml#
$schema: http://devicetree.org/meta-schemas/core.yaml#

title: FPC1155 mBack Home Key & Fingerprint Sensor (Meizu PRO 5)

maintainers:
  - 404698-FDU <pro5-mainline@local>

properties:
  compatible:
    oneOf:
      - items:
          - const: meizu,m86-fpc1155
          - const: fpc,fpc_irq
      - const: fpc,fpc1150

  reg:
    maxItems: 1

  spi-max-frequency: true

  irq-gpios:
    maxItems: 1

  reset-gpios:
    maxItems: 1

  vdd-supply: true

  clocks:
    maxItems: 2

  clock-names:
    items:
      - const: pclk
      - const: sclk

  wakeup-source: true

  controller-data:
    type: object
    additionalProperties: true

required:
  - compatible

additionalProperties: false
```

## Documentation/devicetree/bindings/leds/ti,lm3644.yaml
```yaml
# SPDX-License-Identifier: GPL-2.0-only OR BSD-2-Clause
%YAML 1.2
---
$id: http://devicetree.org/schemas/leds/ti,lm3644.yaml#
$schema: http://devicetree.org/meta-schemas/core.yaml#

title: TI LM3644 Dual Flash LED Driver

maintainers:
  - 404698-FDU <pro5-mainline@local>

properties:
  compatible:
    items:
      - const: ti,leds-lm3644
      - const: ti,lm3644

  reg:
    maxItems: 1

  hwen-gpios:
    maxItems: 1

  strobe-gpios:
    maxItems: 1

required:
  - compatible
  - reg

additionalProperties: false
```

## Documentation/devicetree/bindings/media/i2c/sony,imx230.yaml
```yaml
# SPDX-License-Identifier: GPL-2.0-only OR BSD-2-Clause
%YAML 1.2
---
$id: http://devicetree.org/schemas/media/i2c/sony,imx230.yaml#
$schema: http://devicetree.org/meta-schemas/core.yaml#

title: Sony IMX230 21MP CMOS Image Sensor

maintainers:
  - 404698-FDU <pro5-mainline@local>

properties:
  compatible:
    const: sony,imx230

  reg:
    maxItems: 1

  clocks:
    maxItems: 1

  clock-frequency:
    $ref: /schemas/types.yaml#/definitions/uint32

  vana-supply: true
  vdig-supply: true
  vif-supply: true
  vcm-supply: true
  vdrv-supply: true

  reset-gpios:
    maxItems: 1

  orientation:
    $ref: /schemas/types.yaml#/definitions/uint32

  rotation:
    $ref: /schemas/types.yaml#/definitions/uint32

  port:
    $ref: /schemas/graph.yaml#/$defs/port-base
    additionalProperties: false

    properties:
      endpoint:
        $ref: /schemas/media/video-interfaces.yaml#
        additionalProperties: false

        properties:
          data-lanes:
            minItems: 1
            maxItems: 4
          link-frequencies: true
          remote-endpoint: true

required:
  - compatible
  - reg
  - clocks
  - port

additionalProperties: false
```

## Documentation/devicetree/bindings/media/samsung,exynos7420-fimc-bns.yaml
```yaml
# SPDX-License-Identifier: GPL-2.0-only OR BSD-2-Clause
%YAML 1.2
---
$id: http://devicetree.org/schemas/media/samsung,exynos7420-fimc-bns.yaml#
$schema: http://devicetree.org/meta-schemas/core.yaml#

title: Samsung Exynos7420 FIMC-BNS Camera Interface

maintainers:
  - 404698-FDU <pro5-mainline@local>

properties:
  compatible:
    const: samsung,exynos7420-fimc-bns

  reg:
    maxItems: 1

  interrupts:
    maxItems: 1

  clocks:
    minItems: 1
    maxItems: 8

  samsung,sysreg:
    $ref: /schemas/types.yaml#/definitions/phandle
    description: Phandle to the SYSREG syscon.

  power-domains:
    maxItems: 1

  iommus:
    maxItems: 1

  port:
    $ref: /schemas/graph.yaml#/properties/port

  ports:
    $ref: /schemas/graph.yaml#/properties/ports

required:
  - compatible
  - reg
  - interrupts
  - clocks

additionalProperties: false
```

## Documentation/devicetree/bindings/media/samsung,exynos7420-mipi-csis.yaml
```yaml
# SPDX-License-Identifier: GPL-2.0-only OR BSD-2-Clause
%YAML 1.2
---
$id: http://devicetree.org/schemas/media/samsung,exynos7420-mipi-csis.yaml#
$schema: http://devicetree.org/meta-schemas/core.yaml#

title: Samsung Exynos7420 MIPI CSI-2 Receiver

maintainers:
  - 404698-FDU <pro5-mainline@local>

properties:
  compatible:
    const: samsung,exynos7420-mipi-csis

  reg:
    maxItems: 1

  interrupts:
    maxItems: 1

  clocks:
    maxItems: 3

  clock-names:
    items:
      - const: pclk
      - const: wrap
      - const: phy

  clock-frequency: true

  power-domains:
    maxItems: 1

  phys:
    maxItems: 1

  phy-names:
    const: csis

  ports:
    $ref: /schemas/graph.yaml#/properties/ports

required:
  - compatible
  - reg
  - interrupts
  - clocks
  - clock-names

additionalProperties: false
```

## Documentation/devicetree/bindings/misc/meizu,m86-tsu6721.yaml
```yaml
# SPDX-License-Identifier: GPL-2.0-only OR BSD-2-Clause
%YAML 1.2
---
$id: http://devicetree.org/schemas/misc/meizu,m86-tsu6721.yaml#
$schema: http://devicetree.org/meta-schemas/core.yaml#

title: TI TSU6721 Micro-USB Switch (Meizu PRO 5)

maintainers:
  - 404698-FDU <pro5-mainline@local>

properties:
  compatible:
    const: meizu,m86-tsu6721

  reg:
    maxItems: 1

required:
  - compatible
  - reg

additionalProperties: false
```

## Documentation/devicetree/bindings/misc/samsung,exynos-mipi-lli.yaml
```yaml
# SPDX-License-Identifier: GPL-2.0-only OR BSD-2-Clause
%YAML 1.2
---
$id: http://devicetree.org/schemas/misc/samsung,exynos-mipi-lli.yaml#
$schema: http://devicetree.org/meta-schemas/core.yaml#

title: Samsung Exynos MIPI LLI Host & MPHY

maintainers:
  - 404698-FDU <pro5-mainline@local>

properties:
  compatible:
    const: samsung,exynos-mipi-lli

  reg:
    minItems: 1
    maxItems: 3

  samsung,sysreg:
    $ref: /schemas/types.yaml#/definitions/phandle
    description: Phandle to the SYSREG syscon.

  memory-region:
    maxItems: 1

  modem-name:
    $ref: /schemas/types.yaml#/definitions/string

  modems:
    type: object
    additionalProperties: true

  interrupts:
    minItems: 1
    maxItems: 2

  clocks:
    minItems: 1
    maxItems: 24

  clock-names:
    minItems: 1
    maxItems: 24

  "#address-cells":
    const: 1

  "#size-cells":
    const: 1

  ranges: true

patternProperties:
  "^mphy@":
    type: object
    additionalProperties: false
    properties:
      compatible:
        enum:
          - samsung,exynos-mipi-lli-mphy
          - samsung,exynos-mipi-lli-combo-mphy
      reg:
        minItems: 1
        maxItems: 2
      has_pma:
        type: boolean
      modem-name:
        $ref: /schemas/types.yaml#/definitions/string
      modems:
        type: object
        additionalProperties: true
    required:
      - compatible
      - reg

required:
  - compatible
  - reg

additionalProperties: false
```

## Documentation/devicetree/bindings/misc/sec_modem,modem_pdata.yaml
```yaml
# SPDX-License-Identifier: GPL-2.0-only OR BSD-2-Clause
%YAML 1.2
---
$id: http://devicetree.org/schemas/misc/sec_modem,modem_pdata.yaml#
$schema: http://devicetree.org/meta-schemas/core.yaml#

title: Samsung Exynos7420 Shannon 333 Modem Interface

maintainers:
  - 404698-FDU <pro5-mainline@local>

properties:
  compatible:
    const: sec_modem,modem_pdata

  iodevs:
    type: object
    additionalProperties: true

required:
  - compatible

additionalProperties: true
```

## Documentation/devicetree/bindings/misc/spi_boot_link.yaml
```yaml
# SPDX-License-Identifier: GPL-2.0-only OR BSD-2-Clause
%YAML 1.2
---
$id: http://devicetree.org/schemas/misc/spi_boot_link.yaml#
$schema: http://devicetree.org/meta-schemas/core.yaml#

title: Shannon Modem SPI Boot Link Device

maintainers:
  - 404698-FDU <pro5-mainline@local>

properties:
  compatible:
    const: spi_boot_link

  reg:
    maxItems: 1

  spi-max-frequency: true

  controller-data:
    type: object
    additionalProperties: true

required:
  - compatible
  - reg

additionalProperties: false
```

## Documentation/devicetree/bindings/pci/samsung,exynos7420-pro5-pcie-enumeration.yaml
```yaml
# SPDX-License-Identifier: GPL-2.0-only OR BSD-2-Clause
%YAML 1.2
---
$id: http://devicetree.org/schemas/pci/samsung,exynos7420-pro5-pcie-enumeration.yaml#
$schema: http://devicetree.org/meta-schemas/core.yaml#

title: Exynos7420 PRO 5 PCIe Enumeration-Only Root Complex

maintainers:
  - 404698-FDU <pro5-mainline@local>

allOf:
  - $ref: /schemas/pci/pci-bus.yaml#

properties:
  compatible:
    const: samsung,exynos7420-pro5-pcie-enumeration

  reg:
    minItems: 5
    maxItems: 5

  reg-names:
    items:
      - const: elbi
      - const: phy
      - const: pcs
      - const: dbi
      - const: config

  clocks:
    minItems: 1
    maxItems: 24

  clock-names:
    minItems: 1
    maxItems: 24

  interrupts:
    minItems: 1
    maxItems: 4

  interrupt-names:
    minItems: 1
    maxItems: 4

  reg-on-gpios:
    maxItems: 1

  samsung,pcie-sysreg:
    $ref: /schemas/types.yaml#/definitions/phandle-array
    description: Phandle and offset pair to PCIe SYSREG register.

  samsung,pmu-syscon:
    $ref: /schemas/types.yaml#/definitions/phandle
    description: Phandle to the PMU syscon node.

  samsung,pcie-cmu-control:
    $ref: /schemas/types.yaml#/definitions/phandle
    description: Phandle to the PCIe CMU control syscon node.

  num-lanes: true
  max-link-speed: true

required:
  - compatible
  - reg
  - reg-names

unevaluatedProperties: false
```

## Documentation/devicetree/bindings/power/supply/meizu,m86-bq27532.yaml
```yaml
# SPDX-License-Identifier: GPL-2.0-only OR BSD-2-Clause
%YAML 1.2
---
$id: http://devicetree.org/schemas/power/supply/meizu,m86-bq27532.yaml#
$schema: http://devicetree.org/meta-schemas/core.yaml#

title: TI BQ27532 Fuel Gauge (Read-Only Mainline Wrapper)

maintainers:
  - 404698-FDU <pro5-mainline@local>

allOf:
  - $ref: power-supply.yaml#

properties:
  compatible:
    const: meizu,m86-bq27532-readonly

  reg:
    maxItems: 1

required:
  - compatible
  - reg

unevaluatedProperties: false
```

## Documentation/devicetree/bindings/rng/samsung,exynos7420-trng.yaml
```yaml
# SPDX-License-Identifier: GPL-2.0-only OR BSD-2-Clause
%YAML 1.2
---
$id: http://devicetree.org/schemas/rng/samsung,exynos7420-trng.yaml#
$schema: http://devicetree.org/meta-schemas/core.yaml#

title: Samsung Exynos7420 True Random Number Generator

maintainers:
  - 404698-FDU <pro5-mainline@local>

properties:
  compatible:
    items:
      - const: samsung,exynos7420-trng
      - const: samsung,exynos850-trng

required:
  - compatible

additionalProperties: false
```

## Documentation/devicetree/bindings/sound/audience,es705.yaml
```yaml
# SPDX-License-Identifier: GPL-2.0-only OR BSD-2-Clause
%YAML 1.2
---
$id: http://devicetree.org/schemas/sound/audience,es705.yaml#
$schema: http://devicetree.org/meta-schemas/core.yaml#

title: Audience eS705 Audio DSP

maintainers:
  - 404698-FDU <pro5-mainline@local>

properties:
  compatible:
    const: audience,es705

  reg:
    maxItems: 1

  spi-max-frequency: true
  spi-cpha: true

  clocks:
    minItems: 1
    maxItems: 2

  clock-names:
    items:
      - const: mclk
      - const: clk32k

  vdd-core-supply: true

  reset-gpios:
    maxItems: 1

  wakeup-gpios:
    maxItems: 1

  "#sound-dai-cells":
    const: 1

  controller-data:
    type: object
    additionalProperties: true

required:
  - compatible
  - reg

additionalProperties: false
```
